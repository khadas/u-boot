## drivers/amlogic/media/vout/lcd/backlight/Kconfig
```kconfig
config AML_LCD_BACKLIGHT
	bool "backlight control for lcd"
	depends on AML_LCD
	help
	  Support for lcd backlight control


source "drivers/amlogic/media/vout/lcd/backlight/bl_ldim/Kconfig"
source "drivers/amlogic/media/vout/lcd/backlight/bl_extern/Kconfig"
```

## drivers/amlogic/media/vout/lcd/backlight/bl_extern/Kconfig
```kconfig
config AML_LCD_BL_EXTERN
	bool "backlight extern device driver"
	depends on AML_LCD_BACKLIGHT
	help
	  Support for lcd backlight extern device, such as i2c, spi...

config AML_LCD_BL_EXTERN_I2C_LP8556
	bool "i2c_lp8556 bl extern device driver"
	depends on AML_LCD_BL_EXTERN
	help
	  Support for lp8556 bl extern device

config AML_LCD_BL_EXTERN_MIPI_LT070ME05
	bool "mipi_lt070me05 bl extern device driver"
	depends on AML_LCD_BL_EXTERN
	help
	  Support for mipi_lt070me05 bl extern device
```

## drivers/amlogic/media/vout/lcd/backlight/bl_ldim/Kconfig
```kconfig
config AML_LCD_BL_LDIM
	bool "backlight local dimming driver"
	depends on AML_LCD_BACKLIGHT
	help
	  Support for lcd backlight local dimming

config AML_LCD_BL_LDIM_IW7027
	bool "iw7027 local dimming driver"
	depends on AML_LCD_BL_LDIM
	help
	  Support for iw7027 local dimming device

config AML_LCD_BL_LDIM_OB3350
	bool "ob3350 local dimming driver"
	depends on AML_LCD_BL_LDIM
	help
	  Support for ob3350 local dimming device

config AML_LCD_BL_LDIM_BLMCU
	bool "blmcu local dimming driver"
	depends on AML_LCD_BL_LDIM
	help
	  Support for blmcu local dimming device
```

## drivers/amlogic/media/vout/lcd/bl_extern/Kconfig
```kconfig
config AML_BL_EXTERN
	bool "bl_extern driver for lcd"
	help
	  Support for lcd bl_extern controlling

config AML_BL_EXTERN_I2C_LP8556
	bool "bl_extern LP8556 driver for lcd"
	help
	  Support for lcd bl_extern LP8556 controlling

config AML_BL_EXTERN_MIPI_IT070ME05
	bool "bl_extern MIPI_IT070ME05 driver for lcd"
	help
	  Support for lcd bl_extern MIPI_IT070ME05 controlling
```

## drivers/amlogic/media/vout/lcd/bl_ldim/Kconfig
```kconfig
config AML_BL_LOCAL_DIMMING
	bool "bl_local_dimming driver for lcd"
	help
	  Support for lcd bl_local_dimming controlling

config AML_LOCAL_DIMMING_GLOBAL
	bool "bl ldim global dimming driver for lcd"
	help
	  Support for lcd bl ldim global dimming controlling

config AML_LOCAL_DIMMING_OB3350
	bool "bl ldim OB3350 driver for lcd"
	help
	  Support for lcd bl ldim OB3350 controlling

config AML_LOCAL_DIMMING_IW7027
	bool "bl ldim IW7027 driver for lcd"
	help
	  Support for lcd bl ldim IW7027 controlling
```

## drivers/amlogic/media/vout/lcd/lcd_extern/Kconfig
```kconfig
config AML_LCD_EXTERN
	bool "lcd extern device driver"
	depends on AML_LCD
	help
	  Support for lcd extern device

config AML_LCD_EXTERN_I2C_ANX6862_7911
	bool "i2c_anx6862_7911 extern device driver"
	depends on AML_LCD_EXTERN
	help
	  Support for anx6862_7911 extern device

config AML_LCD_EXTERN_I2C_RT6947
	bool "i2c_rt6947 extern device driver"
	depends on AML_LCD_EXTERN
	help
	  Support for rt6947 extern device
```

## drivers/amlogic/media/vout/lcd/lcd_tablet/Kconfig
```kconfig
config AML_LCD_TABLET
	bool "lcd_tablet output"
	depends on AML_LCD
	help
	  Support for lcd tablet mode output
```

## drivers/amlogic/media/vout/lcd/lcd_tv/Kconfig
```kconfig
config AML_LCD_TV
	bool "lcd_tv output"
	depends on AML_LCD
	help
	  Support for lcd tv mode output
```

## drivers/amlogic/mkl/Kconfig
```kconfig
config AML_MKL
        tristate "Amlogic Keyladder driver"
        default n
        help
          Amlogic Keyladder driver

          Enable for the Amlogic AML keyladder
```

## drivers/amlogic/pm/Kconfig
```kconfig
config CPU_PM
        bool "power management"
	default y
	help
	Select this for boards which use power management
```

## drivers/amlogic/provision/Kconfig
```kconfig
config FAT_WRITE
	bool "enable fat write"
config AML_FACTORY_PROVISION
	bool "enable factory provision"
```

## drivers/clk/meson/Kconfig
```kconfig
config CLK_MESON_G12
	bool "Support G12A/G12B Clock"
	depends on CLK
	help
		This option is used to enable the meson g12a clock
		driver.

config CLK_MESON_A1
	bool "Support A1 Clock"
	depends on CLK
	help
		This option is used to enable the meson a1 clock
		driver.

config CLK_MESON_C1
	bool "Support C1 Clock"
	depends on CLK
	help
		This option is used to enable the meson c1 clock
		driver.

config CLK_MESON_S4
	bool "Support S4 Clock"
	depends on CLK
	help
		This option is used to enable the meson s4 clock
		driver

config CLK_MESON_SC2
        bool "Support SC2 Clock"
        depends on CLK
        help
          This option is used to enable the meson sc2 clock
          driver

config CLK_MESON_C2
        bool "Support C2 Clock"
        depends on CLK
        help
          This option is used to enable the meson c2 clock
          driver.

config CLK_MESON_T7
        bool "Support T7 Clock"
        depends on CLK
        help
          This option is used to enable the meson t7 clock
          driver

config CLK_MESON_P1
	bool "Support P1 Clock"
	depends on CLK
	help
		This option is used to enable the meson p1 clock
		driver.

config CLK_MESON_T3
        bool "Support T3 Clock"
        depends on CLK
        help
          This option is used to enable the meson t3 clock
          driver

config CLK_MESON_A5
        bool "Support A5 Clock"
        depends on CLK
        help
          This option is used to enable the meson a5 clock
          driver

config CLK_MESON_C3
        bool "Support C3 Clock"
        depends on CLK
        help
          This option is used to enable the meson a5 clock
          driver
```

## drivers/efuse/Kconfig
```kconfig
config EFUSE
	bool "AML EFUSE Support"
	help
	  Enable support for the Amlogic EFUSE controller.
```

## drivers/image_check/Kconfig
```kconfig
config IMAGE_CHECK
	bool "AML IMAGE CHECK Support"
	select AML_CRYPTO
	help
	  Enable support for the Amlogic image check.
```

## drivers/mtd/nand/spi/Kconfig
```kconfig
menuconfig MTD_SPI_NAND
	bool "SPI NAND device Support"
	depends on MTD && DM_SPI
	select MTD_NAND_CORE
	select SPI_MEM
	help
	  This is the framework for the SPI NAND device drivers.

config SPI_NAND_AML_ADVANCED
	bool "SPI Nand meson advanced support"
	depends on MTD_SPI_NAND
	default n
	help
	  SC2 needs to support a new burning mode (ADVANCED), we implement
	  it based on the original discrete modem. If say Y enabled ADVANCED
	  mode, spinand will use ADVANCED mode to burning.
	  If unsure, say N
```

## drivers/pinctrl/meson/Kconfig
```kconfig
if ARCH_MESON

config PINCTRL_MESON
	bool

config PINCTRL_MESON8_PMX
	bool

config PINCTRL_MESON_AXG_PMX
	bool

config PINCONF_MESON_G12A
	bool

config PINCTRL_MESON_GXBB
	bool "Amlogic Meson GXBB SoC pinctrl driver"
	depends on PINCTRL_GENERIC
	depends on PINCONF
	select PINCTRL_MESON
	select PINCTRL_MESON8_PMX

config PINCTRL_MESON_GXL
	bool "Amlogic Meson GXL SoC pinctrl driver"
	depends on PINCTRL_GENERIC
	depends on PINCONF
	select PINCTRL_MESON
	select PINCTRL_MESON8_PMX

config PINCTRL_MESON_AXG
	bool "Amlogic Meson AXG SoC pinctrl driver"
	depends on PINCTRL_GENERIC
	depends on PINCONF
	select PINCTRL_MESON
	select PINCTRL_MESON_AXG_PMX

config PINCTRL_MESON_G12A
	bool "Amlogic Meson G12A SoC pinctrl driver"
	depends on PINCTRL_GENERIC
	depends on PINCONF
	select PINCTRL_MESON
	select PINCTRL_MESON_AXG_PMX
	select PINCONF_MESON_G12A

config PINCTRL_MESON_A1
	bool "Amlogic Meson A1 SoC pinctrl driver"
	depends on PINCTRL_GENERIC
	depends on PINCONF
	select PINCTRL_MESON
	select PINCTRL_MESON_AXG_PMX
	select PINCONF_MESON_G12A

config PINCTRL_MESON_C1
	bool "Amlogic Meson C1 SoC pinctrl driver"
	depends on PINCTRL_GENERIC
	depends on PINCONF
	select PINCTRL_MESON
	select PINCTRL_MESON_AXG_PMX
	select PINCONF_MESON_G12A

config PINCTRL_MESON_S4
	bool "Amlogic Meson S4 SoC pinctrl driver"
	depends on PINCTRL_GENERIC
	depends on PINCONF
	select PINCTRL_MESON
	select PINCTRL_MESON_AXG_PMX
	select PINCONF_MESON_G12A

config PINCTRL_MESON_SC2
	bool "Amlogic Meson SC2 SoC pinctrl driver"
	depends on PINCTRL_GENERIC
	depends on PINCONF
	select PINCTRL_MESON
	select PINCTRL_MESON_AXG_PMX
	select PINCONF_MESON_G12A

config PINCTRL_MESON_C2
	bool "Amlogic Meson C2 SoC pinctrl driver"
	depends on PINCTRL_GENERIC
	depends on PINCONF
	select PINCTRL_MESON
	select PINCTRL_MESON_AXG_PMX
	select PINCONF_MESON_G12A

config PINCTRL_MESON_T7
	bool "Amlogic Meson T7 SoC pinctrl driver"
	depends on PINCTRL_GENERIC
	depends on PINCONF
	select PINCTRL_MESON
	select PINCTRL_MESON_AXG_PMX
	select PINCONF_MESON_G12A

config PINCTRL_MESON_T3
	bool "Amlogic Meson T3 SoC pinctrl driver"
	depends on PINCTRL_GENERIC
	depends on PINCONF
	select PINCTRL_MESON
	select PINCTRL_MESON_AXG_PMX
	select PINCONF_MESON_G12A

config PINCTRL_MESON_P1
	bool "Amlogic Meson P1 SoC pinctrl driver"
	depends on PINCTRL_GENERIC
	depends on PINCONF
	select PINCTRL_MESON
	select PINCTRL_MESON_AXG_PMX
	select PINCONF_MESON_G12A

config PINCTRL_MESON_A5
	bool "Amlogic Meson A5 SoC pinctrl driver"
	depends on PINCTRL_GENERIC
	depends on PINCONF
	select PINCTRL_MESON
	select PINCTRL_MESON_AXG_PMX
	select PINCONF_MESON_G12A

config PINCTRL_MESON_C3
	bool "Amlogic Meson C3 SoC pinctrl driver"
	depends on PINCTRL_GENERIC
	depends on PINCONF
	select PINCTRL_MESON
	select PINCTRL_MESON_AXG_PMX
	select PINCONF_MESON_G12A

endif
```

## drivers/spi/meson/Kconfig
```kconfig
if DM_SPI

config AML_SPICC
	bool "Amlogic SPICC Driver"
	help
	  Enable support for SPICC on all meson SoCs.
	  nothing

config AML_SPICCV2
	bool "Amlogic SPICC_V2 Driver"
	help
	  Enable support for SPICC v2 on meson a4 SoCs.
	  It is a new spi controller to support,
	  - PIO, DMA-memory, DMA-SG,
	  - Descriptor list
	  - Dual/Quad SPI
	  - LCD data/command mode(9bits or pin)

config AML_SPIFC
	bool "Amlogic SPIFC Driver"
	help
	  Enable support for SPI Flash Controller on meson SoCs.
	  It should be set when user want SPI NAND or SPI NOR on meson SoCs.
	  If SPI NAND/SPI FLASH is enabled, please open it in defconfig

config AML_SPIFCV2
	bool "Amlogic SPIFC_V2 Driver"
	help
	  Enable support for SPI Flash Controller v2 on a1 meson SoCs.
	  It should be set when user want SPI NAND or SPI NOR on a1 meson SoCs.
	  If SPI NAND/SPI FLASH is enabled, please open it in defconfig

config AML_SPI_NFC
	bool "Amlogic SPI NFC with Host ECC Driver"
	default y
	help
	  Enable support for SPI Flash Controller with host ECC on meson SoCs.
	  It should be set when user want SPI NAND or SPI NOR on meson SoCs.
	  If SPI NAND/SPI FLASH is enabled, please open it in defconfig

config AML_SPI_NFC_DISABLE_HOST_ECC
	bool "disable Host ECC Driver"
	default y if AML_SPI_NFC
	help
	  Disable host ECC on meson SoCs.
	  It should be set when user use SPI NAND without ECC or want to use
	  Host ECC.

endif
```

## drivers/tee/uta/Kconfig
```kconfig
# UTA User Trusted Application Configuration
config TEE_UTA
	bool "Support User TA"
	depends on OPTEE
	help
		The user TA can be loaded
```

## drivers/usb/gadget/v2_burning/Kconfig
```kconfig
#
# USB burning
#

menuconfig AML_V2_FACTORY_BURN
	bool "Amlogic V2 burning Support"
	---help---
	  Say Y here if you want to support amlogic factory burning

if AML_V2_FACTORY_BURN

config AML_FACTORY_BURN_LOCAL_UPGRADE
	bool "AML factory burning support local sdcard and usb disk"
	---help---
	  Say Y here if you want to support upgrade from sdcard and usb disk

config SD_BURNING_SUPPORT_UI
	depends on CMD_BMP
	bool "AML factory sdcard and usb disk with UI progress info"
	---help---
	  Say Y here if you want to support sdcard and usb disk with UI progress info


config USB_BURNING_TOOL
	bool "USB burning tool support"
	select USB_DEVICE_V2
	---help---
	  Say Y here if you want to update firmware through the update command and usb tool

config AML_USB_BURN_FULL_SPEED
    depends on USB_BURNING_TOOL
    bool "usb burning driver runing on Full-speed mode"
    default n
	---help---
	  Change Y Only when u testing on usb or FS mode have problem

#config USB_DEVICE_V2
#	bool
endif # AML_V2_FACTORY_BURN
```

## drivers/usb/gadget/v3_burning/Kconfig
```kconfig
#
# AML V3 burning
#
menuconfig AML_V3_FACTORY_BURN
	bool "Amlogic V3 burning Support"
	depends on AML_STORE_WRAPPER
	---help---
	  Say Y here if you want to support amlogic V3 factory burning

if AML_V3_FACTORY_BURN

config AML_V3_USB_TOOl
	bool "DNL USB burning support"
	select USB_GADGET_DOWNLOAD
	select FASTBOOT_DWC_PCD #for fastboot/dwc_pcd.o fastboot/dwc_pcd_irq.o
	depends on USB_GADGET
	---help---
	  Say Y here if you want to update firmware by aml DNL tool

config V3_USB_BURN_FULL_SPEED
    depends on AML_V3_USB_TOOl
    bool "usb burning driver runing on Full-speed mode"
    default n
	---help---
	  Change Y Only when u testing on usb or FS mode have problem

config V3_KEY_BURNING_SUPPORT
	depends on UNIFY_KEY_MANAGE
	bool "support burning unifykey in v3 burning"
	default y
	select AML_V2_FACTORY_BURN

config SUPPORT_BACKUP_PART_NORMAL_ERASE
    bool "support backup part when normal erasing"
    default n

config BACKUP_PART_NORMAL_ERASE
    depends on SUPPORT_BACKUP_PART_NORMAL_ERASE
    string "config backup part name"
    help
        This configure define part which need backup to mem before normal erase
        backup before erasing, and restore it after erasing
        There is probablity data lost if erasing failed or write failed



endif #AML_V3_FACTORY_BURN
```

## lib/libxbc/Kconfig
```kconfig
config XBC
	bool "Support Bootconfig"
	help
	  U-Boot can be configured to set androidboot cmdline to bootconfig.
	  Selecting this option will enable bootconfig
          will read bootconfig from vendor_boot.img
          and write bootconfig in uboot to vendor_boot.img
          If devices cannot support it, save bootconfig to
          bootargs.
```
