## arch/arm/mach-rockchip/rk3576/Kconfig
```kconfig
if ROCKCHIP_RK3576

config TARGET_EVB_RK3576
	bool "EVB_RK3576"
	select BOARD_LATE_INIT
	help
	  RK3576 EVB is a evaluation board for Rockchp RK3576.

config TARGET_KEDGE_2L
	bool "Khadas Edge 2L"
	select BOARD_LATE_INIT
	help
	  Khadas Edge 2L

config SYS_SOC
	default "rockchip"

config SYS_MALLOC_F_LEN
	default 0x400

source board/rockchip/evb_rk3576/Kconfig
source board/khadas/rk3576-khadas-edge-2l/Kconfig

endif
```

## board/khadas/rk3576-khadas-edge-2l/Kconfig
```kconfig
if TARGET_KEDGE_2L

config SYS_BOARD
	default "rk3576-khadas-edge-2l"

config SYS_VENDOR
	default "khadas"

config SYS_CONFIG_NAME
	default "kedge-2l"

config BOARD_SPECIFIC_OPTIONS # dummy
	def_bool y

endif
```
