// SPDX-License-Identifier: (GPL-2.0+ OR MIT)
/*
 * Copyright (c) 2019 Amlogic, Inc. All rights reserved.
 */

#include "meson-t3x.dtsi"
#include "meson-t3x-mali.dtsi"

/ {
	compatible = "amlogic,txxx", "amlogic,meson-t3x";
};

&ethmac {
	phy-mode = "rmii";
	phy-handle = <&internal_phy>;
};
