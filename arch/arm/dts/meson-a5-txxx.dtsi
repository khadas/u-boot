// SPDX-License-Identifier: (GPL-2.0+ OR MIT)
/*
 * Copyright (c) 2019 Amlogic, Inc. All rights reserved.
 */

#include "meson-a5.dtsi"
#include "meson-a5-mali.dtsi"

/ {
	compatible = "amlogic,txxx", "amlogic,meson-s4";
};

&ethmac {
	phy-mode = "rmii";
//	phy-handle = <&external_phy>;
};
