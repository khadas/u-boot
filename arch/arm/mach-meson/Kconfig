## board/amlogic/a1_ad401/Kconfig
```kconfig
if TARGET_A1_AD401

config SYS_SOC
	default "a1"

config SYS_BOARD
	default "a1_ad401"

config SYS_VENDOR
	default "amlogic"

config SYS_CONFIG_NAME
	default "a1_ad401"

config CMD_PLLTEST
	bool "support plltest command"
	default y
	help
	  support plltest command

endif
```

## board/amlogic/a1_ad402/Kconfig
```kconfig
if TARGET_A1_AD402

config SYS_SOC
	default "a1"

config SYS_BOARD
	default "a1_ad402"

config SYS_VENDOR
	default "amlogic"

config SYS_CONFIG_NAME
	default "a1_ad402"

config CMD_PLLTEST
	bool "support plltest command"
	default y
	help
	  support plltest command

config DTB_BIND_KERNEL
    bool "load dtb from boot part but not flash rsv"
    default n

endif
```

## board/amlogic/a1_ad403/Kconfig
```kconfig
if TARGET_A1_AD403

config SYS_SOC
	default "a1"

config SYS_BOARD
	default "a1_ad403"

config SYS_VENDOR
	default "amlogic"

config SYS_CONFIG_NAME
	default "a1_ad403"

config CMD_PLLTEST
	bool "support plltest command"
	default y

config DTB_BIND_KERNEL
	bool "load dtb from boot part but not flash rsv"
    	default n

endif
```

## board/amlogic/a1_ad409/Kconfig
```kconfig
if TARGET_A1_AD409

config SYS_SOC
	default "a1"

config SYS_BOARD
	default "a1_ad409"

config SYS_VENDOR
	default "amlogic"

config SYS_CONFIG_NAME
	default "a1_ad409"

endif
```

## board/amlogic/a1_ad40ae/Kconfig
```kconfig
if TARGET_A1_AD40AE

config SYS_SOC
	default "a1"

config SYS_BOARD
	default "a1_ad40ae"

config SYS_VENDOR
	default "amlogic"

config SYS_CONFIG_NAME
	default "a1_ad40ae"

config CMD_PLLTEST
	bool "support plltest command"
	default y

config DTB_BIND_KERNEL
	bool "load dtb from boot part but not flash rsv"
	default n

endif
```

## board/amlogic/a1_skt_v1/Kconfig
```kconfig
if TARGET_A1_SKT_V1

config SYS_SOC
	default "a1"

config SYS_BOARD
	default "a1_skt_v1"

config SYS_VENDOR
	default "amlogic"

config SYS_CONFIG_NAME
	default "a1_skt_v1"

endif
```

## board/amlogic/a4_ba409/Kconfig
```kconfig
if TARGET_A4_BA409

config SYS_SOC
	default "a4"

config SYS_BOARD
	default "a4_ba409"

config SYS_VENDOR
	default "amlogic"

config SYS_CONFIG_NAME
	default "a4_ba409"

config DTB_BIND_KERNEL
    bool "load dtb from boot part but not flash rsv"
    default n

config AML_REBOOT
		bool "reboot cmd"
		default y
		help
			support uboot reboot cmd
endif
```

## board/amlogic/a5_av400_zircon/Kconfig
```kconfig
if TARGET_A5_AV400_ZIRCON

config SYS_SOC
	default "a5"

config SYS_BOARD
	default "a5_av400_zircon"

config SYS_VENDOR
	default "amlogic"

config SYS_CONFIG_NAME
	default "a5_av400_zircon"

config DTB_BIND_KERNEL
    bool "load dtb from boot part but not flash rsv"
    default n

config AML_REBOOT
       bool "reboot cmd"
       default y
       help
         support uboot reboot cmd

config ZIRCON_GPT
       bool "enable gpt for zircon"
       default n

config ZIRCON_PARTITIONS
	bool "Zircon partitions support"
	default n

config ZIRCON_ABR
	bool "Zircon A/B/R support"
	default n

endif
```

## board/amlogic/a5_skt/Kconfig
```kconfig
if TARGET_A5_SKT

config SYS_SOC
	default "a5"

config SYS_BOARD
	default "a5_skt"

config SYS_VENDOR
	default "amlogic"

config SYS_CONFIG_NAME
	default "a5_skt"

config DTB_BIND_KERNEL
    bool "load dtb from boot part but not flash rsv"
    default n

config CMD_PLLTEST
	bool "support plltest command"
	default n
	help
	  support plltest command

config AML_REBOOT
       bool "reboot cmd"
       default y
       help
         support uboot reboot cmd
endif
```

## board/amlogic/c1_ae400/Kconfig
```kconfig
if TARGET_C1_AE400

config SYS_SOC
	default "c1"

config SYS_BOARD
	default "c1_ae400"

config SYS_VENDOR
	default "amlogic"

config SYS_CONFIG_NAME
	default "c1_ae400"

config DTB_BIND_KERNEL
    bool "load dtb from boot part but not flash rsv"
    default n

config CMD_PLLTEST
	bool "support plltest command"
	default y
	help
	  support plltest command

endif
```

## board/amlogic/c1_ae409/Kconfig
```kconfig
if TARGET_C1_AE409

config SYS_SOC
	default "c1"

config SYS_BOARD
	default "c1_ae409"

config SYS_VENDOR
	default "amlogic"

config SYS_CONFIG_NAME
	default "c1_ae409"

config DTB_BIND_KERNEL
    bool "load dtb from boot part but not flash rsv"
    default n

config CMD_PLLTEST
	bool "support plltest command"
	default y
	help
	  support plltest command

endif
```

## board/amlogic/c1_skt/Kconfig
```kconfig
if TARGET_C1_SKT

config SYS_SOC
	default "c1"

config SYS_BOARD
	default "c1_skt"

config SYS_VENDOR
	default "amlogic"

config SYS_CONFIG_NAME
	default "c1_skt"

endif
```

## board/amlogic/c2_af401/Kconfig
```kconfig
if TARGET_C2_AF401

config SYS_SOC
	default "c2"

config SYS_BOARD
	default "c2_af401"

config SYS_VENDOR
	default "amlogic"

config SYS_CONFIG_NAME
	default "c2_af401"

config DTB_BIND_KERNEL
    bool "load dtb from boot part but not flash rsv"
    default n

config CMD_PLLTEST
	bool "support plltest command"
	default y
	help
	  support plltest command

endif
```

## board/amlogic/c2_af419/Kconfig
```kconfig
if TARGET_C2_AF419

config SYS_SOC
	default "c2"

config SYS_BOARD
	default "c2_af419"

config SYS_VENDOR
	default "amlogic"

config SYS_CONFIG_NAME
	default "c2_af419"

config DTB_BIND_KERNEL
    bool "load dtb from boot part but not flash rsv"
    default n

config CMD_PLLTEST
	bool "support plltest command"
	default y
	help
	  support plltest command

endif
```

## board/amlogic/c3_aw409_emmc/Kconfig
```kconfig
if TARGET_C3_AW409_EMMC

config SYS_SOC
	default "c3"

config SYS_BOARD
	default "c3_aw409_emmc"

config SYS_VENDOR
	default "amlogic"

config SYS_CONFIG_NAME
	default "c3_aw409_emmc"

config DTB_BIND_KERNEL
    bool "load dtb from boot part but not flash rsv"
    default n

config AML_REBOOT
       bool "reboot cmd"
       default y
       help
         support uboot reboot cmd
endif
```

## board/amlogic/c3_aw419/Kconfig
```kconfig
if TARGET_C3_AW419

config SYS_SOC
	default "c3"

config SYS_BOARD
	default "c3_aw419"

config SYS_VENDOR
	default "amlogic"

config SYS_CONFIG_NAME
	default "c3_aw419"

config DTB_BIND_KERNEL
    bool "load dtb from boot part but not flash rsv"
    default n

config CMD_PLLTEST
	bool "support plltest command"
	default n
	help
	  support plltest command

config AML_REBOOT
       bool "reboot cmd"
       default y
       help
         support uboot reboot cmd
endif
```

## board/amlogic/defconfigs/a1_ad402_nand_rtos_defconfig
```kconfig
CONFIG_ARM=y
CONFIG_ARCH_MESON=y
CONFIG_SYS_TEXT_BASE=0x00000000
CONFIG_MESON_A1=y
CONFIG_UBOOT_RUN_IN_SRAM=y
CONFIG_AML_TSENSOR=y
CONFIG_AML_TSENSOR_COOL=y
CONFIG_NEED_BL32=y
CONFIG_A1_AD402_NAND_RTOS=y
CONFIG_DEBUG_UART_BASE=0xfe001c00
CONFIG_DEBUG_UART_CLOCK=24000000
CONFIG_DEBUG_UART=y
CONFIG_OF_BOARD_SETUP=y
CONFIG_BOOTDELAY=2
CONFIG_BOOTCOMMAND="run storeboot"
CONFIG_BOARD_LATE_INIT=y
# CONFIG_DISPLAY_CPUINFO is not set
# CONFIG_DISPLAY_BOARDINFO is not set
CONFIG_SYS_PROMPT="ad402# "
# CONFIG_CMD_BDI is not set
# CONFIG_CMD_IMI is not set
CONFIG_CMD_CLKMSR=y
CONFIG_CMD_GPIO=y
CONFIG_CMD_I2C=y
# CONFIG_CMD_LOADB is not set
# CONFIG_CMD_LOADS is not set
CONFIG_CMD_MTD=y
CONFIG_CMD_SF=y
CONFIG_CMD_SPI=y
CONFIG_CMD_USB=y
CONFIG_CMD_SARADC=y
# CONFIG_CMD_SETEXPR is not set
CONFIG_CMD_CACHE=y
# CONFIG_CMD_MISC is not set
CONFIG_CMD_MTDPARTS=y
CONFIG_AML_STORAGE=y
# CONFIG_CMD_RSVMEM is not set
CONFIG_CMD_WATCHDOG=y
CONFIG_CMD_JTAG=y
CONFIG_OF_CONTROL=y
CONFIG_OF_EMBED=y
CONFIG_DEFAULT_DEVICE_TREE="meson-a1-a113l-ad402"
CONFIG_ENV_IS_IN_STORAGE=y
# CONFIG_REGMAP is not set
CONFIG_ADC=y
CONFIG_SARADC_MESON=y
CONFIG_SARADC_MESON_G12A=y
CONFIG_CLK=y
CONFIG_CLK_MESON=y
CONFIG_CLK_MESON_A1=y
CONFIG_USB_FUNCTION_FASTBOOT=y
CONFIG_FASTBOOT_FLASH=y
CONFIG_DM_GPIO=y
CONFIG_DM_I2C=y
CONFIG_SYS_I2C_MESON=y
CONFIG_LED=y
CONFIG_AML_LED_PWM=y
CONFIG_MISC=y
# CONFIG_MMC is not set
CONFIG_MTD=y
CONFIG_AML_MTDPART=y
CONFIG_NAND=y
CONFIG_DM_SPI_FLASH=y
CONFIG_PHY=y
CONFIG_AML_USB3_PHY=y
CONFIG_AML_USB2_PHY=y
CONFIG_PINCTRL=y
CONFIG_PINCONF=y
CONFIG_PINCTRL_MESON_A1=y
CONFIG_DM_REGULATOR=y
CONFIG_DM_PWM=y
CONFIG_PWM_MESON=y
CONFIG_DEBUG_UART_MESON=y
CONFIG_DEBUG_UART_ANNOUNCE=y
CONFIG_DEBUG_UART_SKIP_INIT=y
CONFIG_MESON_SERIAL=y
CONFIG_SPI=y
CONFIG_DM_SPI=y
CONFIG_AML_SPICC=y
CONFIG_AML_SPIFCV2=y
CONFIG_USB=y
CONFIG_DM_USB=y
CONFIG_AML_USB=y
CONFIG_USB_XHCI_HCD=y
CONFIG_USB_XHCI_DWC3=y
CONFIG_USB_GADGET=y
CONFIG_USB_GADGET_VENDOR_NUM=0x1b8e
CONFIG_AML_V3_FACTORY_BURN=y
CONFIG_AML_V3_USB_TOOl=y
CONFIG_WDT=y
CONFIG_WDT_MESON=y
CONFIG_AML_DRIVER=y
CONFIG_AML_MEDIA=y
CONFIG_UNIFY_KEY_MANAGE=y
CONFIG_SECURE_STORAGE=y
CONFIG_EFUSE=y
CONFIG_SHA1=y
CONFIG_OF_LIBFDT_OVERLAY=y
```

## board/amlogic/defconfigs/c1_ae400_defconfig
```kconfig
CONFIG_ARM=y
CONFIG_ARCH_MESON=y
CONFIG_SYS_TEXT_BASE=0x00000000
CONFIG_MESON_C1=y
CONFIG_AML_TSENSOR=y
CONFIG_AML_TSENSOR_COOL=y
CONFIG_NEED_BL32=y
CONFIG_C1_AE400=y
CONFIG_DEBUG_UART_BASE=0xfe001c00
CONFIG_DEBUG_UART_CLOCK=24000000
CONFIG_DEBUG_UART=y
CONFIG_OF_BOARD_SETUP=y
CONFIG_BOOTCOMMAND="run storeboot"
CONFIG_BOARD_LATE_INIT=y
# CONFIG_DISPLAY_CPUINFO is not set
# CONFIG_DISPLAY_BOARDINFO is not set
CONFIG_SYS_PROMPT="c1_ae400# "
# CONFIG_CMD_BDI is not set
# CONFIG_CMD_IMI is not set
CONFIG_CMD_CLKMSR=y
CONFIG_CMD_GPIO=y
CONFIG_CMD_I2C=y
# CONFIG_CMD_LOADB is not set
# CONFIG_CMD_LOADS is not set
CONFIG_CMD_MMC=y
CONFIG_CMD_MTD=y
CONFIG_AML_STORAGE=y
CONFIG_CMD_SF=y
CONFIG_CMD_SPI=y
CONFIG_CMD_USB=y
CONFIG_CMD_SARADC=y
# CONFIG_CMD_SETEXPR is not set
CONFIG_CMD_CACHE=y
CONFIG_CMD_MTDPARTS=y
# CONFIG_CMD_RSVMEM is not set
CONFIG_CMD_WATCHDOG=y
CONFIG_CMD_JTAG=y
CONFIG_AML_PARTITION=y
CONFIG_OF_CONTROL=y
CONFIG_OF_EMBED=y
CONFIG_DEFAULT_DEVICE_TREE="meson-c1-c308x-ae400"
CONFIG_ENV_IS_IN_STORAGE=y
# CONFIG_REGMAP is not set
CONFIG_ADC=y
CONFIG_SARADC_MESON=y
CONFIG_SARADC_MESON_G12A=y
CONFIG_CLK=y
CONFIG_CLK_MESON=y
CONFIG_CLK_MESON_C1=y
CONFIG_USB_FUNCTION_FASTBOOT=y
CONFIG_FASTBOOT_FLASH_MMC_DEV=1
CONFIG_FASTBOOT_FLASH_NAND=y
CONFIG_FASTBOOT_FLASH=y
CONFIG_DM_GPIO=y
CONFIG_DM_I2C=y
CONFIG_SYS_I2C_MESON=y
CONFIG_MISC=y
CONFIG_DM_MMC=y
CONFIG_MMC_HS200_SUPPORT=y
CONFIG_MMC_MESON_GX=y
CONFIG_MTD=y
CONFIG_NAND=y
CONFIG_MESON_NFC=y
# CONFIG_MTD_SPI_NAND is not set
CONFIG_DM_SPI_FLASH=y
CONFIG_DM_ETH=y
CONFIG_PHY=y
CONFIG_AML_USB3_PHY=y
CONFIG_AML_USB2_PHY=y
CONFIG_PINCTRL=y
CONFIG_PINCONF=y
CONFIG_PINCTRL_MESON_C1=y
CONFIG_DM_REGULATOR=y
CONFIG_DEBUG_UART_MESON=y
CONFIG_DEBUG_UART_ANNOUNCE=y
CONFIG_DEBUG_UART_SKIP_INIT=y
CONFIG_MESON_SERIAL=y
CONFIG_SPI=y
CONFIG_DM_SPI=y
CONFIG_AML_SPICC=y
CONFIG_AML_SPIFCV2=y
CONFIG_USB=y
CONFIG_DM_USB=y
CONFIG_AML_USB=y
CONFIG_USB_XHCI_HCD=y
CONFIG_USB_XHCI_DWC3=y
CONFIG_USB_GADGET=y
CONFIG_USB_GADGET_VENDOR_NUM=0x1b8e
CONFIG_AML_FACTORY_BURN_LOCAL_UPGRADE=y
CONFIG_AML_V3_FACTORY_BURN=y
CONFIG_AML_V3_USB_TOOl=y
CONFIG_WDT=y
CONFIG_WDT_MESON=y
CONFIG_AML_DRIVER=y
CONFIG_AML_MEDIA=y
CONFIG_UNIFY_KEY_MANAGE=y
CONFIG_SECURE_STORAGE=y
CONFIG_SECURE_POWER_CONTROL=y
CONFIG_EFUSE=y
CONFIG_SHA1=y
CONFIG_OF_LIBFDT_OVERLAY=y
```

## board/amlogic/defconfigs/c2_af402_defconfig
```kconfig
CONFIG_ARM=y
CONFIG_ARCH_MESON=y
CONFIG_SYS_TEXT_BASE=0x00000000
CONFIG_MESON_C2=y
CONFIG_AML_BL33_COMPRESS_ENABLE=y
CONFIG_AML_TSENSOR=y
CONFIG_AML_TSENSOR_COOL=y
CONFIG_NEED_BL32=y
CONFIG_C2_AF402=y
CONFIG_DEBUG_UART_BASE=0xfe001c00
CONFIG_DEBUG_UART_CLOCK=24000000
CONFIG_DEBUG_UART=y
# CONFIG_DISTRO_DEFAULTS is not set
CONFIG_ANDROID_BOOT_IMAGE=y
CONFIG_OF_BOARD_SETUP=y
CONFIG_BOARD_LATE_INIT=y
# CONFIG_DISPLAY_CPUINFO is not set
# CONFIG_DISPLAY_BOARDINFO is not set
CONFIG_HUSH_PARSER=y
CONFIG_SYS_PROMPT="c2_af402# "
# CONFIG_CMD_BDI is not set
# CONFIG_CMD_CONSOLE is not set
# CONFIG_CMD_DSPRUN is not set
# CONFIG_CMD_DSPSET is not set
# CONFIG_CMD_ELF is not set
# CONFIG_CMD_IMI is not set
# CONFIG_CMD_XIMG is not set
# CONFIG_CMD_EXPORTENV is not set
# CONFIG_CMD_IMPORTENV is not set
# CONFIG_CMD_EDITENV is not set
# CONFIG_CMD_LZMADEC is not set
# CONFIG_CMD_UNZIP is not set
CONFIG_CMD_CLKMSR=y
CONFIG_CMD_GPIO=y
# CONFIG_CMD_LOADB is not set
# CONFIG_CMD_LOADS is not set
CONFIG_CMD_MTD=y
# CONFIG_CMD_NAND is not set
CONFIG_AML_STORAGE=y
CONFIG_CMD_SF=y
# CONFIG_CMD_ITEST is not set
# CONFIG_CMD_SOURCE is not set
# CONFIG_CMD_SETEXPR is not set
# CONFIG_CMD_MISC is not set
# CONFIG_CMD_RSVMEM is not set
# CONFIG_CMD_DDR_TEST is not set
CONFIG_CMD_WATCHDOG=y
# CONFIG_CMD_EFUSE is not set
# CONFIG_PARTITIONS is not set
CONFIG_OF_CONTROL=y
CONFIG_OF_EMBED=y
CONFIG_DEFAULT_DEVICE_TREE="meson-c2-c305x-af402"
CONFIG_ENV_IS_IN_STORAGE=y
# CONFIG_NET is not set
CONFIG_HAVE_BLOCK_DEVICE=y
CONFIG_CLK=y
CONFIG_CLK_MESON=y
CONFIG_CLK_MESON_C2=y
CONFIG_DM_GPIO=y
# CONFIG_INPUT is not set
# CONFIG_MMC is not set
CONFIG_MTD=y
CONFIG_MTD_SPI_NAND=y
CONFIG_DM_SPI_FLASH=y
CONFIG_PHY=y
CONFIG_AML_USB3_PHY=y
CONFIG_AML_USB2_PHY=y
CONFIG_PINCTRL=y
CONFIG_PINCONF=y
CONFIG_PINCTRL_MESON_C2=y
CONFIG_DM_REGULATOR=y
CONFIG_DEBUG_UART_MESON=y
CONFIG_DEBUG_UART_ANNOUNCE=y
CONFIG_DEBUG_UART_SKIP_INIT=y
CONFIG_MESON_SERIAL=y
CONFIG_SPI=y
CONFIG_DM_SPI=y
CONFIG_AML_SPIFCV2=y
CONFIG_USB=y
CONFIG_DM_USB=y
CONFIG_AML_USB=y
CONFIG_USB_XHCI_HCD=y
CONFIG_USB_XHCI_DWC3=y
CONFIG_USB_GADGET=y
CONFIG_AML_V3_FACTORY_BURN=y
CONFIG_AML_V3_USB_TOOl=y
CONFIG_WDT=y
CONFIG_WDT_MESON=y
CONFIG_AML_DRIVER=y
CONFIG_SECURE_STORAGE=y
CONFIG_SECURE_POWER_CONTROL=y
CONFIG_EFUSE=y
CONFIG_SHA1=y
# CONFIG_EFI_LOADER is not set
```

## board/amlogic/defconfigs/g12a_u200_v1_defconfig
```kconfig
CONFIG_ARM=y
CONFIG_ARCH_MESON=y
CONFIG_SYS_TEXT_BASE=0x01000000
CONFIG_MESON_G12A=y
CONFIG_FIP_IMG_SUPPORT=y
CONFIG_AML_TSENSOR=y
CONFIG_AML_TSENSOR_COOL=y
CONFIG_AML_OSCRING=n
CONFIG_NEED_BL32=y
CONFIG_TARGET_G12A_U200_V1=y
CONFIG_DEBUG_UART_BASE=0xff803000
CONFIG_DEBUG_UART_CLOCK=24000000
CONFIG_DEBUG_UART=y
CONFIG_OF_BOARD_SETUP=y
CONFIG_BOOTDELAY=1
CONFIG_BOOTCOMMAND="run storeboot"
# CONFIG_DISPLAY_CPUINFO is not set
# CONFIG_DISPLAY_BOARDINFO is not set
CONFIG_SYS_PROMPT="g12a_u200_v1# "
# CONFIG_CMD_BDI is not set
# CONFIG_CMD_DSPRUN is not set
# CONFIG_CMD_DSPSET is not set
# CONFIG_CMD_IMI is not set
CONFIG_CMD_GPIO=y
CONFIG_CMD_I2C=y
CONFIG_CMD_MTD=y
# CONFIG_CMD_LOADS is not set
CONFIG_CMD_MMC=y
CONFIG_CMD_SF=y
CONFIG_CMD_SPI=y
CONFIG_CMD_USB=y
CONFIG_CMD_SARADC=y
# CONFIG_CMD_SETEXPR is not set
CONFIG_CMD_BMP=y
CONFIG_CMD_MTDPARTS=y
CONFIG_AML_STORAGE=y
CONFIG_BOOTLOADER_CONTROL_BLOCK=y
CONFIG_CMD_BOOTCTOL_AVB=y
CONFIG_CMD_WATCHDOG=y
CONFIG_AML_PARTITION=y
CONFIG_AML_GPT=y
CONFIG_OF_CONTROL=y
CONFIG_DEFAULT_DEVICE_TREE="meson-g12a-s905d2-u200"
CONFIG_ENV_IS_IN_STORAGE=y
CONFIG_ADC=y
CONFIG_SARADC_MESON=y
CONFIG_SARADC_MESON_G12A=y
CONFIG_CLK=y
CONFIG_CLK_MESON=y
CONFIG_CLK_MESON_G12=y
CONFIG_DM_GPIO=y
CONFIG_DM_I2C=y
CONFIG_SYS_I2C_MESON=y
CONFIG_DM_MMC=y
CONFIG_MMC_MESON_GX=y
CONFIG_MTD=y
CONFIG_NAND=y
#CONFIG_SPI_NAND=y
CONFIG_DM_SPI_FLASH=y
CONFIG_PHY=y
CONFIG_AML_USB3_PHY=y
CONFIG_AML_USB2_PHY=y
CONFIG_PINCTRL=y
CONFIG_PINCONF=y
CONFIG_PINCTRL_MESON_G12A=y
CONFIG_DM_REGULATOR=y
CONFIG_DM_PWM=y
CONFIG_PWM_MESON=y
CONFIG_DEBUG_UART_MESON=y
CONFIG_DEBUG_UART_ANNOUNCE=y
CONFIG_DEBUG_UART_SKIP_INIT=y
CONFIG_MESON_SERIAL=y
CONFIG_SPI=y
CONFIG_DM_SPI=y
CONFIG_AML_SPICC=y
CONFIG_USB=y
CONFIG_DM_USB=y
CONFIG_AML_USB=y
CONFIG_USB_XHCI_HCD=y
CONFIG_USB_XHCI_DWC3=y
CONFIG_USB_GADGET=y
CONFIG_USB_GADGET_VENDOR_NUM=0x1b8e
CONFIG_AML_V2_FACTORY_BURN=y
CONFIG_AML_FACTORY_BURN_LOCAL_UPGRADE=y
CONFIG_SD_BURNING_SUPPORT_UI=y
CONFIG_USB_BURNING_TOOL=y
CONFIG_AML_V3_FACTORY_BURN=y
CONFIG_AML_V3_USB_TOOl=y
CONFIG_WDT=y
CONFIG_WDT_MESON=y
CONFIG_AML_DRIVER=y
CONFIG_AML_MEDIA=y
CONFIG_AML_VOUT=y
CONFIG_AML_OSD=y
CONFIG_AML_CANVAS=y
CONFIG_AML_VPP=y
CONFIG_AML_VPU=y
CONFIG_AML_CVBS=y
CONFIG_AML_LCD=y
CONFIG_AML_LCD_TABLET=y
CONFIG_AML_LCD_BACKLIGHT=y
#CONFIG_MESON_NFC=y
CONFIG_UNIFY_KEY_MANAGE=y
CONFIG_SECURE_STORAGE=y
CONFIG_EFUSE=y
CONFIG_OF_LIBFDT_OVERLAY=y
```

## board/amlogic/defconfigs/g12b_w400_debian_v1_defconfig
```kconfig
CONFIG_ARM=y
CONFIG_TARGET_MESON_G12B=y
CONFIG_G12B_W400_DEBIAN_V1=y
CONFIG_DM=y
CONFIG_DM_GPIO=y
CONFIG_AML_GPIO=y
CONFIG_SYS_CONFIG_NAME="g12b_w400_debian_v1"
```
