## configs/sm1_ac200_v1_defconfig
```kconfig
CONFIG_ARM=y
CONFIG_ARCH_MESON=y
CONFIG_SYS_TEXT_BASE=0x01000000
CONFIG_MESON_G12A=y
CONFIG_TARGET_SM1_AC200_V1=y
CONFIG_DM_GPIO=y
CONFIG_DM_MMC=y
CONFIG_AML_GPT=y
CONFIG_CMD_MMC=y
CONFIG_MMC_HS200_SUPPORT=y
CONFIG_MMC_MESON_GX=y
# CONFIG_AML_GPIO=y
CONFIG_SYS_PROMPT="sm1_ac200_v1# "
CONFIG_DEFAULT_DEVICE_TREE="meson-sm1-s905d3-ac200"
CONFIG_BOOTCOMMAND="run storeboot"
CONFIG_BOOTDELAY=1
CONFIG_OF_BOARD_SETUP=y
CONFIG_CPU_CLK=1200
# CONFIG_DISPLAY_CPUINFO is not set
# CONFIG_DISPLAY_BOARDINFO is not set
# CONFIG_CMD_BDI is not set
# CONFIG_CMD_IMI is not set
CONFIG_CMD_GPIO=y
# CONFIG_CMD_LOADS is not set
CONFIG_CMD_SPI=y
CONFIG_CMD_SARADC=y
# CONFIG_CMD_SETEXPR is not set
CONFIG_OF_CONTROL=y
CONFIG_ADC=y
CONFIG_SARADC_MESON=y
CONFIG_CLK=y
CONFIG_CLK_MESON=y
CONFIG_CLK_MESON_G12=y
CONFIG_PINCTRL=y
CONFIG_PINCONF=y
CONFIG_PINCTRL_MESON_G12A=y
CONFIG_DM_REGULATOR=y
CONFIG_DM_PWM=y
CONFIG_PWM_MESON=y
CONFIG_ADC_POWER_KEY_CHAN=2
CONFIG_ADC_POWER_KEY_VAL=0
CONFIG_WDT=y
CONFIG_WDT_MESON=y
CONFIG_CMD_WATCHDOG=y
CONFIG_DM_I2C=y
CONFIG_SYS_I2C_MESON=y
CONFIG_CMD_I2C=y
# CONFIG_AML_BL33_COMPRESS_ENABLE=1
CONFIG_AML_CRYPTO_UBOOT=1
CONFIG_AML_CUSTOMER_ID=0
CONFIG_AML_DRIVER=y
CONFIG_AML_MEDIA=y
CONFIG_AML_VPU=y
CONFIG_AML_VPP=y
CONFIG_AML_CANVAS=y
CONFIG_AML_OSD=y
CONFIG_CMD_BMP=y
CONFIG_AML_VOUT=y
CONFIG_AML_CVBS=y
CONFIG_AML_HDMITX=y
CONFIG_AML_LCD=y
CONFIG_AML_LCD_TV=y
CONFIG_AML_LCD_TABLET=y
CONFIG_AML_LCD_EXTERN=y
CONFIG_AML_BL_EXTERN=y
CONFIG_NEED_BL301=y
CONFIG_NEED_BL32=y
CONFIG_CMD_RSVMEM=y
CONFIG_FIP_IMG_SUPPORT=y
CONFIG_SYS_LONGHELP=y
CONFIG_CMD_MISC=y
CONFIG_CMD_ITEST=y
CONFIG_CMD_CPU_TEMP=1
CONFIG_CMD_LOADB=y
# CONFIG_AML_MESON=1
# CONFIG_AML_MESON_G12A=1
# CONFIG_AML_MESON_GX=1
CONFIG_MESON_NFC=y
CONFIG_AML_SECURE_BOOT_V3=1
CONFIG_AML_SECURE_UBOOT=1
CONFIG_AML_SECURITY_KEY=1
CONFIG_BL2_COPY_NUM=4
CONFIG_BOOTLOADER_CONTROL_BLOCK=y
CONFIG_CMD_BOOTCTOL_AVB=y
CONFIG_BT_WAKEUP=y
CONFIG_CEC_OSD_NAME="AML_TV"
CONFIG_CEC_WAKEUP=y
CONFIG_CMD_SARADC=1
CONFIG_CMD_VIU_PROBE=1
CONFIG_CPU_CLK=1200
CONFIG_DDR4_TIMING_TEST=0
CONFIG_DDR_FULL_TEST=0
CONFIG_DDR_LOW_POWER=0
CONFIG_DDR_PLL_BYPASS=0
# CONFIG_DDR_SIZE=0
CONFIG_DDR_USE_EXT_VREF=0
CONFIG_DDR_ZQ_PD=0
CONFIG_DISCRETE_BOOTLOADER=y
CONFIG_DTB_MEM_ADDR=0x1000000
CONFIG_EFUSE=y
CONFIG_MDUMP_COMPRESS=1
# CONFIG_PLATFORM_POWER_INIT=y
CONFIG_POWER_KEY_NOT_SUPPORTED_FOR_BURN=1
CONFIG_RANDOM_ETHADDR=1
CONFIG_SARADC_CH=2
CONFIG_SD_BURNING_SUPPORT_UI=1
CONFIG_STORE_COMPATIBLE=1
CONFIG_SYS_HUSH_PARSER=y
CONFIG_SYS_NO_FLASH=1
CONFIG_TPL_COPY_NUM=4
CONFIG_TPL_PART_NAME="tpl"
CONFIG_TPL_SIZE_PER_COPY=0x200000
CONFIG_TXLX_USB=1
CONFIG_USB_DEVICE_V2=1
CONFIG_USB=y
CONFIG_CMD_USB=y
CONFIG_USB_STORAGE=y
CONFIG_USB_XHCI_HCD=y
CONFIG_USB_XHCI_DWC3=y
CONFIG_FASTBOOT=y
CONFIG_CMD_FASTBOOT=y
CONFIG_FASTBOOT_DWC_PCD=y
CONFIG_USB_GADGET=y
CONFIG_USB_GADGET_DUALSPEED=y
CONFIG_AML_V2_FACTORY_BURN=y
CONFIG_USB_BURNING_TOOL=y
CONFIG_AML_FACTORY_BURN_LOCAL_UPGRADE=y
CONFIG_SD_BURNING_SUPPORT_UI=y
CONFIG_UNIFY_KEY_MANAGE=y
CONFIG_SECURE_STORAGE=y
CONFIG_VCCK_INIT_VOLTAGE=800
# CONFIG_VDDEE_INIT_VOLTAGE=800
# CONFIG_VDDEE_SLEEP_VOLTAGE=731
CONFIG_DEBUG_UART=y
CONFIG_DEBUG_UART_MESON=y
CONFIG_DEBUG_UART_BASE=0xff803000
CONFIG_DEBUG_UART_CLOCK=24000000
CONFIG_DEBUG_UART_ANNOUNCE=y
CONFIG_DEBUG_UART_SKIP_INIT=y
CONFIG_MESON_SERIAL=y
CONFIG_OF_LIBFDT_OVERLAY=y
CONFIG_CMD_D2PLL=n
CONFIG_CMD_DDRTEST=n
#CONFIG_AML_NAND=y
CONFIG_DM_MTD=y
CONFIG_MTD_UBI=y
#CONFIG_MTD=y
CONFIG_NAND=y
CONFIG_MTD_DEVICE=y
CONFIG_AML_MTD=y
CONFIG_CMD_MTDPARTS=y
#CONFIG_AML_MTDPART=y
CONFIG_AML_STORAGE=y
CONFIG_AML_PARTITION=y
CONFIG_MTD_PARTITIONS=y
CONFIG_DM=y
CONFIG_SPI=y
CONFIG_DM_SPI=y
CONFIG_AML_SPICC=y
CONFIG_PHY=y
CONFIG_DM_USB=y
CONFIG_AML_USB2_PHY=y
CONFIG_AML_USB3_PHY=y
CONFIG_AML_USB=y
CONFIG_DM_ETH=y
#CONFIG_SPI_FLASH=y
CONFIG_DM_SPI_FLASH=y
CONFIG_CMD_SF=y
CONFIG_AML_SPIFC=y
CONFIG_SPI_FLASH_WINBOND=y
#CONFIG_SPI_FLASH_MTD=y
CONFIG_SPI_NAND=y
CONFIG_AML_TSENSOR=y
CONFIG_AML_TSENSOR_COOL=y
CONFIG_AML_OSCRING=n
CONFIG_CMD_EFUSE=y
#CONFIG_CMD_DDR_D2PLL=y
#CONFIG_CMD_DDR_TEST=y
```

## drivers/amlogic/Kconfig
```kconfig
menu "AMLOGIC Drivers"

config AML_DRIVER
	bool "AML drivers Support"
	help
	  Enable support for the Amlogic drivers.

source "drivers/amlogic/media/Kconfig"

source "drivers/amlogic/keymanage/Kconfig"

source "drivers/amlogic/storagekey/Kconfig"

source "drivers/amlogic/power/Kconfig"

source "drivers/amlogic/provision/Kconfig"

source "drivers/amlogic/leds/Kconfig"

source "drivers/amlogic/ir/Kconfig"

source "drivers/amlogic/tee/Kconfig"

source "drivers/amlogic/crypto/Kconfig"

source "drivers/amlogic/mkl/Kconfig"
endmenu
```

## drivers/amlogic/crypto/Kconfig
```kconfig
config AML_CRYPTO
	tristate "Amlogic Crypto driver"
	default n
	help
	  Amlogic Crypto driver

	  Crypto driver for Amlogic DMA device
```

## drivers/amlogic/keymanage/Kconfig
```kconfig
menuconfig UNIFY_KEY_MANAGE
    bool "Amlogic unifykey"
	depends on OF_LIBFDT
    help
        This enables support for keyman (Amlogic key manage),
        A driver providing APIs for flash key and efuse key
if UNIFY_KEY_MANAGE
    config AML_SECURITY_KEY
        depends on SECURE_STORAGE
        bool "Amlogic flash key"
        default y
        select SHA256
        help
            "security key wrapper for APIs bl31"
    config KEYMAN_PROVISION_KEY
        bool "Amlogic burn provision key"
        default y
        help
            "provision key wrapper for burn tool"
endif #if UNIFY_KEY_MANAGE
```

## drivers/amlogic/leds/Kconfig
```kconfig
config MESON_LEDS_STATE_CONTROL
    bool "Amlogic device LEDS control"
    default n
```

## drivers/amlogic/media/Kconfig
```kconfig
config AML_MEDIA
	bool "AML Media drivers Support"
	help
	  Enable support for the Amlogic Media drivers.

config AML_VOUT
	bool "Driver support for video output"
	help
	  Enable support for amlogic video output
	  lcd,cvbs...

config AML_OSD
	bool "Driver support for osd"
	help
	  Enable support for amlogic osd driver.

config AML_CANVAS
	bool "Driver support for canvas"
	help
	  Enable support for amlogic canvas driver.

source "drivers/amlogic/media/osd/Kconfig"

source "drivers/amlogic/media/common/Kconfig"

source "drivers/amlogic/media/vout/Kconfig"
```

## drivers/amlogic/media/common/Kconfig
```kconfig
config AML_VPP
	bool "AML VPP drivers Support"
	help
	  Enable support for the Amlogic VPp drivers.

source "drivers/amlogic/media/common/vpu/Kconfig"
source "drivers/amlogic/media/common/vpp/Kconfig"
```

## drivers/amlogic/media/common/vpu/Kconfig
```kconfig
config AML_VPU
	bool "AML VPU drivers Support"
	help
	  Enable support for the Amlogic VPU drivers.
```

## drivers/amlogic/media/osd/Kconfig
```kconfig
config AML_DOLBY
  bool "AML DOLBY driver support"
  help
    Enable support for the Amlogic DOLBY driver.
```

## drivers/amlogic/media/vout/Kconfig
```kconfig
source "drivers/amlogic/media/vout/cvbs/Kconfig"

source "drivers/amlogic/media/vout/hdmitx/Kconfig"

source "drivers/amlogic/media/vout/lcd/Kconfig"
```

## drivers/amlogic/media/vout/cvbs/Kconfig
```kconfig
config AML_CVBS
	bool "cvbs output for video"
	depends on AML_VOUT
	help
	  Support for cvbs video output
```

## drivers/amlogic/media/vout/hdmitx/Kconfig
```kconfig
menu "AMLOGIC HDMI TX Drivers"

config AML_HDMITX
	bool "Amlogic HDMITX drivers Support"
	depends on AML_VOUT
	help
		HDMITX Output Enable

source "drivers/amlogic/media/vout/hdmitx/hdmitx20/Kconfig"

source "drivers/amlogic/media/vout/hdmitx/hdmitx21/Kconfig"

endmenu
```

## drivers/amlogic/media/vout/hdmitx/hdmitx20/Kconfig
```kconfig
config AML_HDMITX20
	bool "Amlogic HDMITX20 drivers Support"
	depends on AML_HDMITX
	help
		HDMITX20 Output Enable
```

## drivers/amlogic/media/vout/hdmitx/hdmitx21/Kconfig
```kconfig
config AML_HDMITX21
	bool "Amlogic HDMITX21 drivers Support"
	depends on AML_HDMITX
	help
		HDMITX21 Output Enable

source "drivers/amlogic/media/vout/hdmitx/hdmitx21/dsc/Kconfig"
```

## drivers/amlogic/media/vout/hdmitx/hdmitx21/dsc/Kconfig
```kconfig
config AML_DSC_ENC
	bool "Amlogic DSC encoder driver"
	depends on AML_HDMITX21
	help
		support for dsc encoder
```

## drivers/amlogic/media/vout/hdmitx20/Kconfig
```kconfig
menu "AMLOGIC HDMI TX 2.0 Drivers"

config AML_HDMITX20
	bool "Amlogic HDMITX20 drivers Support"
	select AML_VOUT
	help
		HDMITX20 Output Enable

endmenu
```

## drivers/amlogic/media/vout/lcd/Kconfig
```kconfig
menu "AMLOGIC LCD Drivers"

config AML_LCD
	bool "lcd output for video"
	depends on AML_VOUT
	help
	  Support for lcd video output

config AML_LCD_TCON
	bool "tcon output for lcd"
	depends on AML_LCD
	help
	  Support for lcd tcon output

source "drivers/amlogic/media/vout/lcd/lcd_tv/Kconfig"
source "drivers/amlogic/media/vout/lcd/lcd_tablet/Kconfig"
source "drivers/amlogic/media/vout/lcd/lcd_extern/Kconfig"
source "drivers/amlogic/media/vout/lcd/backlight/Kconfig"

endmenu
```
