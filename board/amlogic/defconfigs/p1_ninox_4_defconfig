## board/amlogic/defconfigs/t5w_at301_v1_defconfig
```kconfig
CONFIG_ARM=y
CONFIG_ARCH_MESON=y
CONFIG_SYS_TEXT_BASE=0x01000000
CONFIG_MESON_T5W=y
CONFIG_PXP_EMULATOR=y
CONFIG_NEED_BL32=y
CONFIG_DEBUG_UART_BASE=0xffd23000
CONFIG_DEBUG_UART_CLOCK=24000000
CONFIG_DEBUG_UART=y
CONFIG_OF_BOARD_SETUP=y
CONFIG_BOOTDELAY=1
CONFIG_BOOTCOMMAND="run storeboot"
# CONFIG_DISPLAY_CPUINFO is not set
# CONFIG_DISPLAY_BOARDINFO is not set
CONFIG_SYS_PROMPT="t5w_at301_v1# "
# CONFIG_CMD_BDI is not set
# CONFIG_CMD_DSPRUN is not set
# CONFIG_CMD_DSPSET is not set
# CONFIG_CMD_FDT is not set
# CONFIG_CMD_IMI is not set
CONFIG_CMD_GPIO=y
CONFIG_CMD_CLKMSR=y
# CONFIG_CMD_LOADS is not set
CONFIG_AML_STORAGE=y
CONFIG_CMD_USB=y
CONFIG_CMD_I2C=y
# CONFIG_CMD_SETEXPR is not set
CONFIG_CMD_WATCHDOG=y
CONFIG_OF_CONTROL=y
CONFIG_DEFAULT_DEVICE_TREE="meson-t5w-at301-v1"
CONFIG_CLK=y
CONFIG_CLK_MESON=y
CONFIG_CLK_MESON_T5W=y
CONFIG_USB_FUNCTION_FASTBOOT=y
CONFIG_DM_GPIO=y
# CONFIG_MMC is not set
CONFIG_PHY=y
CONFIG_AML_USB3_PHY=y
CONFIG_AML_USB2_PHY=y
CONFIG_PINCTRL=y
CONFIG_PINCONF=y
CONFIG_PINCTRL_MESON_T5W=y
CONFIG_DM_REGULATOR=y
CONFIG_DEBUG_UART_MESON=y
CONFIG_DEBUG_UART_ANNOUNCE=y
CONFIG_DEBUG_UART_SKIP_INIT=y
CONFIG_MESON_SERIAL=y
CONFIG_USB=y
CONFIG_DM_USB=y
CONFIG_AML_USB=y
CONFIG_USB_XHCI_HCD=y
CONFIG_USB_XHCI_CRG=y
CONFIG_USB_GADGET=y
CONFIG_FASTBOOT_DWC_PCD=y
CONFIG_WDT=y
CONFIG_WDT_MESON=y
CONFIG_AML_DRIVER=y
CONFIG_SECURE_POWER_CONTROL=y
CONFIG_EFUSE=y
CONFIG_DM_I2C=y
CONFIG_SYS_I2C_MESON=y
```

## board/amlogic/defconfigs/t5w_skt_v1_defconfig
```kconfig
CONFIG_ARM=y
CONFIG_TARGET_MESON_T5W=y
CONFIG_T5W_SKT_V1=y
CONFIG_DM=y
CONFIG_DM_GPIO=y
CONFIG_AML_GPIO=y
```

## board/amlogic/defconfigs/t7_an400_lpddr4x_defconfig
```kconfig
CONFIG_ARM=y
CONFIG_ARCH_MESON=y
CONFIG_SYS_TEXT_BASE=0x00000000
CONFIG_MESON_T7=y
CONFIG_AML_TSENSOR=y
CONFIG_AML_TSENSOR_COOL=y
CONFIG_DDR_FULL_FW=y
CONFIG_DDRFW_TYPE="lpddr4"
CONFIG_CHIPSET_NAME="a311d2"
CONFIG_BL30_SELECT="t7_an400_lpddr4x"
CONFIG_T7_AN400_LPDDR4X=y
CONFIG_DEBUG_UART_BASE=0xfe078000
CONFIG_DEBUG_UART_CLOCK=24000000
CONFIG_DEBUG_UART=y
# CONFIG_ANDROID_BOOT_IMAGE is not set
CONFIG_OF_BOARD_SETUP=y
CONFIG_BOOTDELAY=2
CONFIG_BOOTCOMMAND="run storeboot"
CONFIG_BOARD_LATE_INIT=y
# CONFIG_DISPLAY_CPUINFO is not set
# CONFIG_DISPLAY_BOARDINFO is not set
CONFIG_SYS_PROMPT="t7_an400_lpddr4x# "
# CONFIG_CMD_BDI is not set
# CONFIG_CMD_DSPSET is not set
# CONFIG_CMD_IMI is not set
CONFIG_CMD_CLKMSR=y
CONFIG_CMD_GPIO=y
CONFIG_CMD_I2C=y
# CONFIG_CMD_LOADB is not set
# CONFIG_CMD_LOADS is not set
CONFIG_CMD_MMC=y
CONFIG_AML_STORAGE=y
# CONFIG_CMD_PINMUX is not set
CONFIG_CMD_SPI=y
CONFIG_CMD_USB=y
CONFIG_CMD_SARADC=y
# CONFIG_CMD_ITEST is not set
# CONFIG_CMD_SETEXPR is not set
CONFIG_CMD_BMP=y
# CONFIG_CMD_MISC is not set
CONFIG_BOOTLOADER_CONTROL_BLOCK=y
CONFIG_CMD_BOOTCTOL_AVB=y
CONFIG_CMD_WATCHDOG=y
CONFIG_CMD_JTAG=y
CONFIG_CMD_INI=y
CONFIG_AML_PARTITION=y
CONFIG_OF_CONTROL=y
CONFIG_OF_EMBED=y
CONFIG_DEFAULT_DEVICE_TREE="meson-t7-an400-lpddr4x"
CONFIG_ENV_IS_IN_STORAGE=y
# CONFIG_REGMAP is not set
CONFIG_ADC=y
CONFIG_SARADC_MESON_G12A=y
CONFIG_CLK=y
CONFIG_CLK_MESON=y
CONFIG_CLK_MESON_T7=y
CONFIG_USB_FUNCTION_FASTBOOT=y
CONFIG_FASTBOOT_FLASH=y
CONFIG_FASTBOOT_FLASH_MMC_DEV=1
CONFIG_DM_GPIO=y
CONFIG_DM_I2C=y
CONFIG_SYS_I2C_MESON=y
CONFIG_MISC=y
CONFIG_DM_MMC=y
CONFIG_MMC_HS400_SUPPORT=y
CONFIG_MMC_MESON_GX=y
CONFIG_DM_ETH=y
CONFIG_PHY=y
CONFIG_AML_USB3_PHY=y
CONFIG_AML_USB2_PHY=y
CONFIG_PINCTRL=y
CONFIG_PINCONF=y
CONFIG_PINCTRL_MESON_T7=y
CONFIG_DM_REGULATOR=y
CONFIG_DM_PWM=y
CONFIG_PWM_MESON=y
CONFIG_DEBUG_UART_MESON=y
CONFIG_DEBUG_UART_ANNOUNCE=y
CONFIG_DEBUG_UART_SKIP_INIT=y
CONFIG_MESON_SERIAL=y
CONFIG_SPI=y
CONFIG_DM_SPI=y
CONFIG_AML_SPICC=y
CONFIG_TEE=y
CONFIG_OPTEE=y
CONFIG_USB=y
CONFIG_DM_USB=y
CONFIG_AML_USB=y
CONFIG_USB_XHCI_HCD=y
CONFIG_USB_XHCI_CRG=y
CONFIG_USB_GADGET=y
CONFIG_USB_GADGET_CRG=y
CONFIG_AML_V3_FACTORY_BURN=y
CONFIG_AML_V3_USB_TOOl=y
CONFIG_WDT=y
CONFIG_WDT_MESON=y
CONFIG_AML_DRIVER=y
CONFIG_AML_MEDIA=y
CONFIG_AML_VOUT=y
CONFIG_AML_OSD=y
CONFIG_AML_DOLBY=y
CONFIG_AML_VPP=y
CONFIG_AML_VPU=y
CONFIG_AML_HDMITX=y
CONFIG_AML_HDMITX21=y
CONFIG_AML_LCD=y
CONFIG_AML_LCD_TV=y
CONFIG_AML_LCD_TABLET=y
CONFIG_AML_LCD_EXTERN=y
CONFIG_AML_LCD_BACKLIGHT=y
CONFIG_AML_LCD_BL_LDIM=y
CONFIG_AML_LCD_BL_LDIM_IW7027=y
CONFIG_AML_LCD_BL_LDIM_BLMCU=y
CONFIG_UNIFY_KEY_MANAGE=y
CONFIG_SECURE_STORAGE=y
CONFIG_SECURE_POWER_CONTROL=y
CONFIG_MESON_LEDS_STATE_CONTROL=y
CONFIG_EFUSE=y
CONFIG_IMAGE_CHECK=y
CONFIG_XBC=y
CONFIG_SHA1=y
```

## board/amlogic/defconfigs/txhd2_be319_defconfig
```kconfig
CONFIG_ARM=y
CONFIG_ARCH_MESON=y
CONFIG_SYS_TEXT_BASE=0x01000000
CONFIG_MESON_TXHD2=y
CONFIG_PXP_AOCPU=y
CONFIG_AML_TSENSOR=y
CONFIG_NEED_BL32=y
CONFIG_BL30_SELECT="txhd2_be319"
CONFIG_TXHD2_BE319=y
CONFIG_DEBUG_UART_BASE=0xff803000
CONFIG_DEBUG_UART_CLOCK=24000000
CONFIG_DEBUG_UART=y
CONFIG_OF_BOARD_SETUP=y
CONFIG_BOOTDELAY=1
CONFIG_BOOTCOMMAND="run storeboot"
# CONFIG_DISPLAY_CPUINFO is not set
# CONFIG_DISPLAY_BOARDINFO is not set
CONFIG_SYS_PROMPT="txhd2_be319# "
# CONFIG_CMD_BDI is not set
# CONFIG_CMD_DSPRUN is not set
# CONFIG_CMD_DSPSET is not set
# CONFIG_CMD_IMI is not set
CONFIG_CMD_CLKMSR=y
CONFIG_CMD_GPIO=y
CONFIG_CMD_I2C=y
# CONFIG_CMD_LOADS is not set
CONFIG_CMD_MMC=y
CONFIG_CMD_MTD=y
CONFIG_AML_STORAGE=y
CONFIG_CMD_SPI=y
CONFIG_CMD_USB=y
CONFIG_CMD_SARADC=y
# CONFIG_CMD_SETEXPR is not set
# CONFIG_CMD_NET is not set
CONFIG_CMD_BMP=y
CONFIG_CMD_MTDPARTS=y
CONFIG_BOOTLOADER_CONTROL_BLOCK=y
CONFIG_CMD_BOOTCTOL_AVB=y
CONFIG_CMD_WATCHDOG=y
CONFIG_CMD_JTAG=y
CONFIG_CMD_INI=y
CONFIG_AML_PARTITION=y
CONFIG_OF_CONTROL=y
CONFIG_OF_EMBED=y
CONFIG_DEFAULT_DEVICE_TREE="meson-txhd2-be319"
CONFIG_ENV_IS_IN_STORAGE=y
CONFIG_ADC=y
CONFIG_SARADC_MESON_G12A=y
CONFIG_CLK=y
CONFIG_CLK_MESON=y
CONFIG_CLK_MESON_TXHD2=y
CONFIG_USB_FUNCTION_FASTBOOT=y
CONFIG_FASTBOOT_FLASH=y
CONFIG_FASTBOOT_FLASH_MMC_DEV=1
CONFIG_DM_GPIO=y
CONFIG_DM_I2C=y
CONFIG_SYS_I2C_MESON=y
CONFIG_MISC=y
CONFIG_DM_MMC=y
CONFIG_MMC_HS400_SUPPORT=y
CONFIG_MMC_MESON_GX=y
CONFIG_MTD=y
CONFIG_NAND=y
CONFIG_MESON_NFC=y
CONFIG_PHYLIB=y
CONFIG_PHY_AMLOGIC=y
CONFIG_DM_ETH=y
CONFIG_PHY=y
CONFIG_AML_USB3_PHY=y
CONFIG_AML_USB2_PHY=y
CONFIG_PINCTRL=y
CONFIG_PINCONF=y
CONFIG_PINCTRL_MESON_TXHD2=y
CONFIG_DM_REGULATOR=y
CONFIG_DEBUG_UART_MESON=y
CONFIG_DEBUG_UART_ANNOUNCE=y
CONFIG_DEBUG_UART_SKIP_INIT=y
CONFIG_MESON_SERIAL=y
CONFIG_SPI=y
CONFIG_DM_SPI=y
CONFIG_AML_SPICC=y
CONFIG_USB=y
CONFIG_DM_USB=y
CONFIG_AML_USB=y
CONFIG_USB_XHCI_HCD=y
CONFIG_USB_XHCI_CRG=y
CONFIG_USB_GADGET=y
CONFIG_AML_FACTORY_BURN_LOCAL_UPGRADE=y
CONFIG_AML_V3_FACTORY_BURN=y
CONFIG_AML_V3_USB_TOOl=y
CONFIG_WDT=y
CONFIG_WDT_MESON=y
CONFIG_AML_DRIVER=y
CONFIG_AML_MEDIA=y
CONFIG_AML_VOUT=y
CONFIG_AML_OSD=y
CONFIG_AML_CANVAS=y
CONFIG_AML_VPP=y
CONFIG_AML_VPU=y
CONFIG_AML_LCD=y
CONFIG_AML_LCD_TCON=y
CONFIG_AML_LCD_TV=y
CONFIG_AML_LCD_TABLET=y
CONFIG_AML_LCD_EXTERN=y
CONFIG_AML_LCD_BACKLIGHT=y
CONFIG_UNIFY_KEY_MANAGE=y
CONFIG_SECURE_STORAGE=y
CONFIG_SECURE_POWER_CONTROL=y
CONFIG_AML_FACTORY_PROVISION=y
CONFIG_MESON_LEDS_STATE_CONTROL=y
CONFIG_AMLOGIC_TEE=y
CONFIG_EFUSE=y
CONFIG_IMAGE_CHECK=y
CONFIG_XBC=y
# CONFIG_GENERATE_SMBIOS_TABLE is not set
```

## board/amlogic/g12a_u200_v1/Kconfig
```kconfig
if TARGET_G12A_U200_V1

config SYS_SOC
	default "g12a"

config SYS_BOARD
	default "g12a_u200_v1"

config SYS_VENDOR
	default "amlogic"

config SYS_CONFIG_NAME
	default "g12a_u200_v1"

endif
```

## board/amlogic/g12b_w400_v1/Kconfig
```kconfig
if TARGET_G12B_W400_V1

config SYS_BOARD
	default "g12b_w400_v1"

config SYS_VENDOR
	default "amlogic"

config SYS_CONFIG_NAME
	default "g12b_w400_v1"

config CONFIG_AML_ANTIROLLBACK
	bool
	default n

endif
```

## board/amlogic/p1_as400/Kconfig
```kconfig
if TARGET_P1_AS400

config SYS_SOC
	default "P1"

config SYS_BOARD
	default "p1_as400"

config SYS_VENDOR
	default "amlogic"

config SYS_CONFIG_NAME
	default "p1_as400"

config DTB_BIND_KERNEL
    bool "load dtb from boot part but not flash rsv"
    default n

config CMD_PLLTEST
	bool "support plltest command"
	default n
	help
	  support plltest command

config AML_REBOOT
       bool "reboot cmd"
       default y
       help
         support uboot reboot cmd
endif
```

## board/amlogic/s4_ap22cb/Kconfig
```kconfig
if TARGET_S4_AP22CB

config SYS_SOC
	default "s4"

config SYS_BOARD
	default "s4_ap22cb"

config SYS_VENDOR
	default "amlogic"

config SYS_CONFIG_NAME
	default "s4_ap22cb"

config DTB_BIND_KERNEL
    bool "load dtb from boot part but not flash rsv"
    default n

config CMD_PLLTEST
	bool "support plltest command"
	default n
	help
	  support plltest command

config AML_REBOOT
       bool "reboot cmd"
       default y
       help
         support uboot reboot cmd
endif
```

## board/amlogic/s4_bf201/Kconfig
```kconfig
if TARGET_S4_BF201

config SYS_SOC
	default "s4"

config SYS_BOARD
	default "s4_bf201"

config SYS_VENDOR
	default "amlogic"

config SYS_CONFIG_NAME
	default "s4_bf201"

config DTB_BIND_KERNEL
    bool "load dtb from boot part but not flash rsv"
    default y

config AML_REBOOT
       bool "reboot cmd"
       default y
       help
         support uboot reboot cmd
endif
```

## board/amlogic/s4_skt/Kconfig
```kconfig
if TARGET_S4_SKT

config SYS_SOC
	default "s4"

config SYS_BOARD
	default "s4_skt"

config SYS_VENDOR
	default "amlogic"

config SYS_CONFIG_NAME
	default "s4_skt"

config DTB_BIND_KERNEL
    bool "load dtb from boot part but not flash rsv"
    default n

config CMD_PLLTEST
	bool "support plltest command"
	default n
	help
	  support plltest command

config AML_REBOOT
       bool "reboot cmd"
       default y
       help
         support uboot reboot cmd
endif
```

## board/amlogic/s5_ax208/Kconfig
```kconfig
if TARGET_S5_AX208

config SYS_SOC
	default "S5"

config SYS_BOARD
	default "s5_ax208"

config SYS_VENDOR
	default "amlogic"

config SYS_CONFIG_NAME
	default "s5_ax208"

config DTB_BIND_KERNEL
    bool "load dtb from boot part but not flash rsv"
    default n

config AML_REBOOT
       bool "reboot cmd"
       default y
       help
         support uboot reboot cmd
endif
```

## board/amlogic/sc2_ah221/Kconfig
```kconfig
if TARGET_SC2_AH221

config SYS_SOC
	default "sc2"

config SYS_BOARD
	default "sc2_ah221"

config SYS_VENDOR
	default "amlogic"

config SYS_CONFIG_NAME
	default "sc2_ah221"

config DTB_BIND_KERNEL
    bool "load dtb from boot part but not flash rsv"
    default n

config CMD_PLLTEST
	bool "support plltest command"
	default n
	help
	  support plltest command

config AML_REBOOT
	bool "reboot cmd"
	default y
	help
	  support uboot reboot cmd
endif
```

## board/amlogic/sc2_skt/Kconfig
```kconfig
if TARGET_SC2_SKT

config SYS_SOC
	default "sc2"

config SYS_BOARD
	default "sc2_skt"

config SYS_VENDOR
	default "amlogic"

config SYS_CONFIG_NAME
	default "sc2_skt"

config DTB_BIND_KERNEL
    bool "load dtb from boot part but not flash rsv"
    default n

config CMD_PLLTEST
	bool "support plltest command"
	default n
	help
	  support plltest command

config AML_REBOOT
       bool "reboot cmd"
       default y
       help
         support uboot reboot cmd
endif
```

## board/amlogic/sm1_ac200_v1/Kconfig
```kconfig
if TARGET_SM1_AC200_V1

config SYS_BOARD
	default "g12a_u200_v1"

config SYS_VENDOR
	default "amlogic"

config SYS_CONFIG_NAME
	default "g12a_u200_v1"

endif
```

## board/amlogic/t3_skt/Kconfig
```kconfig
if TARGET_T3_SKT

config SYS_SOC
	default "t3"

config SYS_BOARD
	default "t3_skt"

config SYS_VENDOR
	default "amlogic"

config SYS_CONFIG_NAME
	default "t3_skt"

config DTB_BIND_KERNEL
    bool "load dtb from boot part but not flash rsv"
    default n

config CMD_PLLTEST
	bool "support plltest command"
	default n
	help
	  support plltest command

config AML_REBOOT
       bool "reboot cmd"
       default y
       help
         support uboot reboot cmd
endif
```

## board/amlogic/t3_t963d4/Kconfig
```kconfig
if TARGET_T3_T963D4

config SYS_SOC
	default "t3"

config SYS_BOARD
	default "t3_t963d4"

config SYS_VENDOR
	default "amlogic"

config SYS_CONFIG_NAME
	default "t3_t963d4"

config DTB_BIND_KERNEL
    bool "load dtb from boot part but not flash rsv"
    default n

config CMD_PLLTEST
	bool "support plltest command"
	default n
	help
	  support plltest command

config AML_REBOOT
       bool "reboot cmd"
       default y
       help
         support uboot reboot cmd
endif
```
