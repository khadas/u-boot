## board/amlogic/defconfigs/p1_ninox_4_defconfig
```kconfig
CONFIG_ARM=y
CONFIG_ARCH_MESON=y
CONFIG_SYS_TEXT_BASE=0x00000000
CONFIG_MESON_P1=y
CONFIG_AML_TSENSOR=y
CONFIG_DDRFW_TYPE="lpddr4_lpddr5"
CONFIG_BL30_SELECT="p1_ninox_4"
CONFIG_P1_NINOX_4=y
CONFIG_DEBUG_UART_BASE=0xfe078000
CONFIG_DEBUG_UART_CLOCK=24000000
CONFIG_DEBUG_UART=y
CONFIG_OF_BOARD_SETUP=y
CONFIG_BOOTCOMMAND="run storeboot"
CONFIG_BOARD_LATE_INIT=y
# CONFIG_DISPLAY_CPUINFO is not set
# CONFIG_DISPLAY_BOARDINFO is not set
CONFIG_SYS_PROMPT="p1_ninox_4# "
# CONFIG_CMD_BDI is not set
# CONFIG_CMD_DSPSET is not set
CONFIG_CMD_STARTM4=y
# CONFIG_CMD_IMI is not set
CONFIG_CMD_CLKMSR=y
CONFIG_CMD_GPIO=y
CONFIG_CMD_I2C=y
# CONFIG_CMD_LOADB is not set
# CONFIG_CMD_LOADS is not set
CONFIG_CMD_MMC=y
CONFIG_AML_STORAGE=y
# CONFIG_CMD_PINMUX is not set
CONFIG_CMD_USB=y
CONFIG_CMD_SARADC=y
# CONFIG_CMD_SETEXPR is not set
# CONFIG_CMD_MISC is not set
CONFIG_BOOTLOADER_CONTROL_BLOCK=y
CONFIG_CMD_BOOTCTOL_AVB=y
# CONFIG_CMD_DDR_TEST is not set
CONFIG_CMD_WATCHDOG=y
CONFIG_CMD_JTAG=y
CONFIG_AML_PARTITION=y
CONFIG_OF_CONTROL=y
CONFIG_OF_EMBED=y
CONFIG_DEFAULT_DEVICE_TREE="meson-p1-ninox-4"
CONFIG_ENV_IS_IN_STORAGE=y
CONFIG_ADC=y
CONFIG_SARADC_MESON_G12A=y
CONFIG_CLK=y
CONFIG_CLK_MESON=y
CONFIG_CLK_MESON_P1=y
CONFIG_USB_FUNCTION_FASTBOOT=y
CONFIG_FASTBOOT_FLASH=y
CONFIG_FASTBOOT_FLASH_MMC_DEV=1
CONFIG_DM_GPIO=y
CONFIG_DM_I2C=y
CONFIG_SYS_I2C_MESON=y
CONFIG_MISC=y
CONFIG_DM_MMC=y
CONFIG_MMC_HS200_SUPPORT=y
CONFIG_MMC_MESON_GX=y
CONFIG_PHYLIB=y
CONFIG_PHY_AMLOGIC=y
CONFIG_DM_ETH=y
CONFIG_PHY=y
CONFIG_PINCTRL=y
CONFIG_PINCONF=y
CONFIG_PINCTRL_MESON_P1=y
CONFIG_DM_REGULATOR=y
CONFIG_DEBUG_UART_MESON=y
CONFIG_DEBUG_UART_ANNOUNCE=y
CONFIG_DEBUG_UART_SKIP_INIT=y
CONFIG_MESON_SERIAL=y
CONFIG_TEE=y
CONFIG_OPTEE=y
CONFIG_USB=y
CONFIG_DM_USB=y
CONFIG_AML_USB=y
CONFIG_USB_XHCI_HCD=y
CONFIG_USB_XHCI_CRG=y
CONFIG_USB_GADGET=y
CONFIG_USB_GADGET_CRG=y
CONFIG_AML_V3_FACTORY_BURN=y
CONFIG_AML_V3_USB_TOOl=y
CONFIG_WDT=y
CONFIG_WDT_MESON=y
CONFIG_AML_DRIVER=y
CONFIG_UNIFY_KEY_MANAGE=y
CONFIG_SECURE_STORAGE=y
CONFIG_SECURE_POWER_CONTROL=y
CONFIG_EFUSE=y
CONFIG_IMAGE_CHECK=y
CONFIG_SHA1=y
```

## board/amlogic/defconfigs/s5_pxp_defconfig
```kconfig
CONFIG_ARM=y
CONFIG_ARCH_MESON=y
CONFIG_SYS_TEXT_BASE=0x00000000
CONFIG_MESON_S5=y
# CONFIG_AML_REBOOT is not set
CONFIG_DEBUG_UART_BASE=0xfe078000
CONFIG_DEBUG_UART_CLOCK=24000000
CONFIG_DEBUG_UART=y
CONFIG_OF_BOARD_SETUP=y
CONFIG_BOOTCOMMAND="echo bootcmd"
CONFIG_BOARD_LATE_INIT=y
# CONFIG_DISPLAY_CPUINFO is not set
# CONFIG_DISPLAY_BOARDINFO is not set
CONFIG_SYS_PROMPT="s5_pxp# "
# CONFIG_CMD_BDI is not set
# CONFIG_CMD_DSPSET is not set
# CONFIG_CMD_IMI is not set
CONFIG_CMD_CLKMSR=y
CONFIG_CMD_GPIO=y
CONFIG_CMD_I2C=y
# CONFIG_CMD_LOADB is not set
# CONFIG_CMD_LOADS is not set
CONFIG_CMD_MMC=y
CONFIG_CMD_MTD=y
CONFIG_AML_STORAGE=y
# CONFIG_CMD_PINMUX is not set
CONFIG_CMD_USB=y
# CONFIG_CMD_ITEST is not set
# CONFIG_CMD_SETEXPR is not set
# CONFIG_CMD_NET is not set
# CONFIG_CMD_MISC is not set
# CONFIG_CMD_RSVMEM is not set
# CONFIG_CMD_DDR_TEST is not set
# CONFIG_CMD_OS_IDENT is not set
CONFIG_CMD_WATCHDOG=y
# CONFIG_CMD_EFUSE is not set
CONFIG_OF_CONTROL=y
CONFIG_OF_EMBED=y
CONFIG_DEFAULT_DEVICE_TREE="meson-s5-pxp"
CONFIG_ENV_IS_IN_STORAGE=y
CONFIG_CLK=y
CONFIG_CLK_MESON=y
CONFIG_CLK_MESON_S5=y
CONFIG_USB_FUNCTION_FASTBOOT=y
CONFIG_FASTBOOT_FLASH=y
CONFIG_FASTBOOT_FLASH_MMC_DEV=1
CONFIG_DM_GPIO=y
CONFIG_DM_I2C=y
CONFIG_SYS_I2C_MESON=y
CONFIG_MISC=y
CONFIG_DM_MMC=y
CONFIG_MMC_HS200_SUPPORT=y
CONFIG_MMC_MESON_GX=y
CONFIG_PHY=y
CONFIG_AML_USB3_PHY=y
CONFIG_AML_USB2_PHY=y
CONFIG_PINCTRL=y
CONFIG_PINCONF=y
CONFIG_PINCTRL_MESON_S5=y
CONFIG_DM_REGULATOR=y
CONFIG_DEBUG_UART_MESON=y
CONFIG_DEBUG_UART_ANNOUNCE=y
CONFIG_DEBUG_UART_SKIP_INIT=y
CONFIG_MESON_SERIAL=y
CONFIG_USB=y
CONFIG_DM_USB=y
CONFIG_AML_USB=y
CONFIG_USB_XHCI_HCD=y
CONFIG_USB_XHCI_CRG=y
CONFIG_USB_GADGET=y
CONFIG_USB_GADGET_CRG=y
CONFIG_AML_V3_FACTORY_BURN=y
CONFIG_AML_V3_USB_TOOl=y
CONFIG_WDT=y
CONFIG_WDT_MESON=y
CONFIG_AML_DRIVER=y
CONFIG_AML_MEDIA=y
CONFIG_AML_VOUT=y
CONFIG_AML_VPU=y
CONFIG_SECURE_POWER_CONTROL=y
CONFIG_SHA1=y
CONFIG_SHA256=y
CONFIG_AML_HDMITX=y
CONFIG_AML_HDMITX21=y
```

## board/amlogic/defconfigs/sc2_ah212_lpddr4_defconfig
```kconfig
CONFIG_ARM=y
CONFIG_ARCH_MESON=y
CONFIG_SYS_TEXT_BASE=0x00000000
CONFIG_MESON_SC2=y
CONFIG_AML_TSENSOR=y
CONFIG_AML_TSENSOR_COOL=y
CONFIG_DDRFW_TYPE="lpddr4"
CONFIG_CHIPSET_NAME="s905x4"
CONFIG_BL30_SELECT="sc2_ah212"
CONFIG_SC2_AH212_LPDDR4=y
CONFIG_DEBUG_UART_BASE=0xfe07a000
CONFIG_DEBUG_UART_CLOCK=24000000
CONFIG_DEBUG_UART=y
CONFIG_OF_BOARD_SETUP=y
CONFIG_BOOTCOMMAND="run storeboot"
CONFIG_BOARD_LATE_INIT=y
# CONFIG_DISPLAY_CPUINFO is not set
# CONFIG_DISPLAY_BOARDINFO is not set
CONFIG_SYS_PROMPT="sc2_ah212_lpddr4# "
# CONFIG_CMD_BDI is not set
CONFIG_CMD_DTIMG=y
# CONFIG_CMD_IMI is not set
CONFIG_CMD_CLKMSR=y
CONFIG_CMD_GPIO=y
CONFIG_CMD_I2C=y
# CONFIG_CMD_LOADB is not set
# CONFIG_CMD_LOADS is not set
CONFIG_CMD_MMC=y
CONFIG_CMD_MTD=y
CONFIG_AML_STORAGE=y
CONFIG_CMD_SPI=y
CONFIG_CMD_USB=y
CONFIG_CMD_SARADC=y
CONFIG_CMD_IR=y
# CONFIG_CMD_SETEXPR is not set
CONFIG_CMD_BMP=y
CONFIG_CMD_CACHE=y
# CONFIG_CMD_MISC is not set
CONFIG_CMD_BOOTCTOL_AVB=y
CONFIG_CMD_WATCHDOG=y
CONFIG_CMD_JTAG=y
CONFIG_CMD_INI=y
CONFIG_AML_PARTITION=y
CONFIG_OF_CONTROL=y
CONFIG_OF_EMBED=y
CONFIG_DEFAULT_DEVICE_TREE="meson-sc2-s905x4-ah212-ddr3"
CONFIG_ENV_IS_IN_STORAGE=y
# CONFIG_REGMAP is not set
CONFIG_ADC=y
CONFIG_SARADC_MESON_G12A=y
CONFIG_CLK=y
CONFIG_CLK_MESON=y
CONFIG_CLK_MESON_SC2=y
CONFIG_USB_FUNCTION_FASTBOOT=y
CONFIG_FASTBOOT_FLASH=y
CONFIG_FASTBOOT_FLASH_MMC_DEV=1
CONFIG_DM_GPIO=y
CONFIG_DM_I2C=y
CONFIG_DM_I2C_GPIO=y
CONFIG_SYS_I2C_MESON=y
CONFIG_MISC=y
CONFIG_DM_MMC=y
CONFIG_MMC_HS200_SUPPORT=y
CONFIG_MMC_MESON_GX=y
CONFIG_AML_MTDPART=y
CONFIG_PHYLIB=y
CONFIG_PHY_AMLOGIC=y
CONFIG_DM_ETH=y
CONFIG_PHY=y
CONFIG_AML_USB3_PHY=y
CONFIG_AML_USB2_PHY=y
CONFIG_PINCTRL=y
CONFIG_PINCONF=y
CONFIG_PINCTRL_MESON_SC2=y
CONFIG_DM_REGULATOR=y
CONFIG_DEBUG_UART_MESON=y
CONFIG_DEBUG_UART_ANNOUNCE=y
CONFIG_DEBUG_UART_SKIP_INIT=y
CONFIG_MESON_SERIAL=y
CONFIG_SPI=y
CONFIG_DM_SPI=y
CONFIG_AML_SPICC=y
CONFIG_TEE=y
CONFIG_OPTEE=y
CONFIG_USB=y
CONFIG_DM_USB=y
CONFIG_AML_USB=y
CONFIG_USB_XHCI_HCD=y
CONFIG_USB_XHCI_DWC3=y
CONFIG_USB_GADGET=y
CONFIG_AML_FACTORY_BURN_LOCAL_UPGRADE=y
CONFIG_AML_V3_FACTORY_BURN=y
CONFIG_AML_V3_USB_TOOl=y
CONFIG_WDT=y
CONFIG_WDT_MESON=y
CONFIG_AML_DRIVER=y
CONFIG_AML_MEDIA=y
CONFIG_AML_VOUT=y
CONFIG_AML_OSD=y
CONFIG_AML_CANVAS=y
CONFIG_AML_DOLBY=y
CONFIG_AML_VPP=y
CONFIG_AML_VPU=y
CONFIG_AML_CVBS=y
CONFIG_AML_HDMITX=y
CONFIG_AML_HDMITX20=y
CONFIG_UNIFY_KEY_MANAGE=y
CONFIG_SECURE_STORAGE=y
CONFIG_SECURE_POWER_CONTROL=y
CONFIG_FAT_WRITE=y
CONFIG_AML_FACTORY_PROVISION=y
CONFIG_MESON_LEDS_STATE_CONTROL=y
CONFIG_MESON_IR=y
CONFIG_EFUSE=y
CONFIG_IMAGE_CHECK=y
CONFIG_XBC=y
CONFIG_SHA1=y
CONFIG_OF_LIBFDT_OVERLAY=y
```

## board/amlogic/defconfigs/sc2_pxp_defconfig
```kconfig
CONFIG_ARM=y
CONFIG_ARCH_MESON=y
CONFIG_SYS_TEXT_BASE=0x00000000
CONFIG_MESON_SC2=y
CONFIG_PXP_EMULATOR=y
CONFIG_DEBUG_UART_BASE=0xfe07a000
CONFIG_DEBUG_UART_CLOCK=24000000
CONFIG_DEBUG_UART=y
CONFIG_OF_BOARD_SETUP=y
CONFIG_BOOTCOMMAND="echo bootcmd"
CONFIG_BOARD_LATE_INIT=y
# CONFIG_DISPLAY_CPUINFO is not set
# CONFIG_DISPLAY_BOARDINFO is not set
CONFIG_SYS_PROMPT="sc2_pxp# "
# CONFIG_CMD_BDI is not set
# CONFIG_CMD_DSPSET is not set
# CONFIG_CMD_IMI is not set
CONFIG_CMD_CLKMSR=y
CONFIG_CMD_GPIO=y
CONFIG_CMD_I2C=y
# CONFIG_CMD_LOADB is not set
# CONFIG_CMD_LOADS is not set
CONFIG_CMD_MMC=y
CONFIG_CMD_MTD=y
CONFIG_AML_STORAGE=y
# CONFIG_CMD_ITEST is not set
# CONFIG_CMD_SETEXPR is not set
# CONFIG_CMD_MISC is not set
CONFIG_CMD_WATCHDOG=y
# CONFIG_CMD_EFUSE is not set
CONFIG_OF_CONTROL=y
CONFIG_OF_EMBED=y
CONFIG_DEFAULT_DEVICE_TREE="meson-sc2-pxp"
CONFIG_ENV_IS_IN_STORAGE=y
# CONFIG_REGMAP is not set
CONFIG_ADC=y
CONFIG_SARADC_MESON_G12A=y
CONFIG_CLK=y
CONFIG_CLK_MESON=y
CONFIG_CLK_MESON_SC2=y
CONFIG_DM_GPIO=y
CONFIG_DM_I2C=y
CONFIG_SYS_I2C_MESON=y
CONFIG_MISC=y
CONFIG_DM_MMC=y
CONFIG_MMC_MESON_GX=y
CONFIG_AML_MTDPART=y
CONFIG_PHY=y
CONFIG_PINCTRL=y
CONFIG_PINCONF=y
CONFIG_PINCTRL_MESON_SC2=y
CONFIG_DM_REGULATOR=y
CONFIG_DEBUG_UART_MESON=y
CONFIG_DEBUG_UART_ANNOUNCE=y
CONFIG_DEBUG_UART_SKIP_INIT=y
CONFIG_MESON_SERIAL=y
CONFIG_WDT=y
CONFIG_WDT_MESON=y
CONFIG_AML_DRIVER=y
CONFIG_AML_MEDIA=y
CONFIG_AML_VOUT=y
CONFIG_AML_OSD=y
CONFIG_AML_CANVAS=y
CONFIG_AML_VPP=y
CONFIG_AML_VPU=y
CONFIG_SECURE_POWER_CONTROL=y
CONFIG_AML_CRYPTO=y
CONFIG_SHA1=y
CONFIG_SHA256=y
```

## board/amlogic/defconfigs/sm1_ac200_debian_v1_defconfig
```kconfig
CONFIG_ARM=y
CONFIG_TARGET_MESON_G12A=y
CONFIG_SM1_AC200_DEBIAN_V1=y
CONFIG_DM=y
CONFIG_DM_GPIO=y
CONFIG_AML_GPIO=y
CONFIG_SYS_CONFIG_NAME="g12a_u200_debian_v1"
```

## board/amlogic/defconfigs/t3_pxp_defconfig
```kconfig
CONFIG_ARM=y
CONFIG_ARCH_MESON=y
CONFIG_SYS_TEXT_BASE=0x00000000
CONFIG_MESON_T3=y
CONFIG_PXP_EMULATOR=y
CONFIG_PXP_DDR=y
CONFIG_AML_TSENSOR=y
CONFIG_AML_TSENSOR_COOL=y
# CONFIG_AML_REBOOT is not set
CONFIG_DEBUG_UART_BASE=0xfe07a000
CONFIG_DEBUG_UART_CLOCK=24000000
CONFIG_DEBUG_UART=y
CONFIG_OF_BOARD_SETUP=y
CONFIG_BOOTCOMMAND="echo bootcmd"
CONFIG_BOARD_LATE_INIT=y
# CONFIG_DISPLAY_CPUINFO is not set
# CONFIG_DISPLAY_BOARDINFO is not set
CONFIG_SYS_PROMPT="t3_pxp# "
# CONFIG_CMD_BDI is not set
# CONFIG_CMD_DSPSET is not set
# CONFIG_CMD_IMI is not set
CONFIG_CMD_CLKMSR=y
CONFIG_CMD_GPIO=y
CONFIG_CMD_I2C=y
# CONFIG_CMD_LOADB is not set
# CONFIG_CMD_LOADS is not set
CONFIG_CMD_MMC=y
CONFIG_CMD_MTD=y
CONFIG_AML_STORAGE=y
# CONFIG_CMD_PINMUX is not set
CONFIG_CMD_USB=y
# CONFIG_CMD_ITEST is not set
# CONFIG_CMD_SETEXPR is not set
# CONFIG_CMD_NET is not set
CONFIG_CMD_BMP=y
# CONFIG_CMD_MISC is not set
# CONFIG_CMD_DDR_TEST is not set
# CONFIG_CMD_OS_IDENT is not set
CONFIG_CMD_WATCHDOG=y
# CONFIG_CMD_EFUSE is not set
CONFIG_OF_CONTROL=y
CONFIG_OF_EMBED=y
CONFIG_DEFAULT_DEVICE_TREE="meson-t3-pxp"
CONFIG_CLK=y
CONFIG_CLK_MESON=y
CONFIG_CLK_MESON_T3=y
CONFIG_USB_FUNCTION_FASTBOOT=y
CONFIG_FASTBOOT_FLASH=y
CONFIG_FASTBOOT_FLASH_MMC_DEV=1
CONFIG_DM_GPIO=y
CONFIG_DM_I2C=y
CONFIG_SYS_I2C_MESON=y
CONFIG_MISC=y
CONFIG_MMC_FBOOT=y
CONFIG_DM_MMC=y
CONFIG_MMC_MESON_GX=y
CONFIG_PHY=y
CONFIG_AML_USB3_PHY=y
CONFIG_AML_USB2_PHY=y
CONFIG_PINCTRL=y
CONFIG_PINCONF=y
CONFIG_PINCTRL_MESON_T3=y
CONFIG_DM_REGULATOR=y
CONFIG_DM_PWM=y
CONFIG_PWM_MESON=y
CONFIG_DEBUG_UART_MESON=y
CONFIG_DEBUG_UART_ANNOUNCE=y
CONFIG_DEBUG_UART_SKIP_INIT=y
CONFIG_MESON_SERIAL=y
CONFIG_USB=y
CONFIG_DM_USB=y
CONFIG_AML_USB=y
CONFIG_USB_XHCI_HCD=y
CONFIG_USB_XHCI_CRG=y
CONFIG_USB_GADGET=y
CONFIG_AML_V3_FACTORY_BURN=y
CONFIG_AML_V3_USB_TOOl=y
CONFIG_WDT=y
CONFIG_WDT_MESON=y
CONFIG_AML_DRIVER=y
CONFIG_AML_MEDIA=y
CONFIG_AML_VOUT=y
CONFIG_AML_OSD=y
CONFIG_AML_VPP=y
CONFIG_AML_VPU=y
CONFIG_AML_LCD=y
CONFIG_AML_LCD_TV=y
CONFIG_AML_LCD_TABLET=y
CONFIG_SECURE_POWER_CONTROL=y
CONFIG_MESON_LEDS_STATE_CONTROL=y
CONFIG_AML_CRYPTO=y
CONFIG_SHA1=y
CONFIG_SHA256=y
```

## board/amlogic/defconfigs/t3_t965d4_defconfig
```kconfig
CONFIG_ARM=y
CONFIG_ARCH_MESON=y
CONFIG_SYS_TEXT_BASE=0x00000000
CONFIG_MESON_T3=y
CONFIG_AML_TSENSOR=y
CONFIG_AML_TSENSOR_COOL=y
CONFIG_CHIPSET_NAME="t965d4"
CONFIG_BL30_SELECT="t3_t965d4"
CONFIG_T3_T965D4=y
CONFIG_DEBUG_UART_BASE=0xfe07a000
CONFIG_DEBUG_UART_CLOCK=24000000
CONFIG_DEBUG_UART=y
CONFIG_OF_BOARD_SETUP=y
CONFIG_BOOTCOMMAND="run storeboot"
CONFIG_BOARD_LATE_INIT=y
# CONFIG_DISPLAY_CPUINFO is not set
# CONFIG_DISPLAY_BOARDINFO is not set
CONFIG_SYS_PROMPT="t3_t965d4# "
# CONFIG_CMD_BDI is not set
# CONFIG_CMD_DSPSET is not set
# CONFIG_CMD_IMI is not set
CONFIG_CMD_CLKMSR=y
CONFIG_CMD_GPIO=y
CONFIG_CMD_I2C=y
# CONFIG_CMD_LOADB is not set
# CONFIG_CMD_LOADS is not set
CONFIG_CMD_MMC=y
CONFIG_CMD_MTD=y
CONFIG_AML_STORAGE=y
# CONFIG_CMD_PINMUX is not set
CONFIG_CMD_SPI=y
CONFIG_CMD_USB=y
CONFIG_CMD_SARADC=y
# CONFIG_CMD_SETEXPR is not set
CONFIG_CMD_BMP=y
# CONFIG_CMD_MISC is not set
CONFIG_BOOTLOADER_CONTROL_BLOCK=y
CONFIG_CMD_BOOTCTOL_AVB=y
# CONFIG_CMD_DDR_TEST is not set
CONFIG_CMD_WATCHDOG=y
CONFIG_CMD_JTAG=y
CONFIG_CMD_INI=y
CONFIG_AML_PARTITION=y
CONFIG_OF_CONTROL=y
CONFIG_OF_EMBED=y
CONFIG_DEFAULT_DEVICE_TREE="meson-t3-t965d4"
CONFIG_ENV_IS_IN_STORAGE=y
CONFIG_ADC=y
CONFIG_SARADC_MESON_G12A=y
CONFIG_CLK=y
CONFIG_CLK_MESON=y
CONFIG_CLK_MESON_T3=y
CONFIG_USB_FUNCTION_FASTBOOT=y
CONFIG_FASTBOOT_FLASH=y
CONFIG_FASTBOOT_FLASH_MMC_DEV=1
CONFIG_DM_GPIO=y
CONFIG_DM_I2C=y
CONFIG_SYS_I2C_MESON=y
CONFIG_MISC=y
CONFIG_MMC_FBOOT=y
CONFIG_DM_MMC=y
CONFIG_MMC_HS200_SUPPORT=y
CONFIG_MMC_MESON_GX=y
CONFIG_PHYLIB=y
CONFIG_PHY_AMLOGIC=y
CONFIG_DM_ETH=y
CONFIG_PHY=y
CONFIG_AML_USB3_PHY=y
CONFIG_AML_USB2_PHY=y
CONFIG_PINCTRL=y
CONFIG_PINCONF=y
CONFIG_PINCTRL_MESON_T3=y
CONFIG_DM_REGULATOR=y
CONFIG_DM_PWM=y
CONFIG_PWM_MESON=y
CONFIG_DEBUG_UART_MESON=y
CONFIG_DEBUG_UART_ANNOUNCE=y
CONFIG_DEBUG_UART_SKIP_INIT=y
CONFIG_MESON_SERIAL=y
CONFIG_SPI=y
CONFIG_DM_SPI=y
CONFIG_AML_SPICC=y
CONFIG_TEE=y
CONFIG_OPTEE=y
CONFIG_USB=y
CONFIG_DM_USB=y
CONFIG_AML_USB=y
CONFIG_USB_XHCI_HCD=y
CONFIG_USB_XHCI_CRG=y
CONFIG_USB_GADGET=y
CONFIG_AML_FACTORY_BURN_LOCAL_UPGRADE=y
CONFIG_SD_BURNING_SUPPORT_UI=y
CONFIG_AML_V3_FACTORY_BURN=y
CONFIG_AML_V3_USB_TOOl=y
CONFIG_WDT=y
CONFIG_WDT_MESON=y
CONFIG_AML_DRIVER=y
CONFIG_AML_MEDIA=y
CONFIG_AML_VOUT=y
CONFIG_AML_OSD=y
CONFIG_AML_VPP=y
CONFIG_AML_VPU=y
CONFIG_AML_LCD=y
CONFIG_AML_LCD_TCON=y
CONFIG_AML_LCD_TV=y
CONFIG_AML_LCD_TABLET=y
CONFIG_AML_LCD_EXTERN=y
CONFIG_AML_LCD_BACKLIGHT=y
CONFIG_AML_LCD_BL_LDIM=y
CONFIG_AML_LCD_BL_LDIM_IW7027=y
CONFIG_UNIFY_KEY_MANAGE=y
CONFIG_SECURE_STORAGE=y
CONFIG_SECURE_POWER_CONTROL=y
CONFIG_MESON_LEDS_STATE_CONTROL=y
CONFIG_AMLOGIC_TEE=y
CONFIG_EFUSE=y
CONFIG_IMAGE_CHECK=y
CONFIG_XBC=y
CONFIG_SHA1=y
```

## board/amlogic/defconfigs/t5d_am319_v1_defconfig
```kconfig
CONFIG_ARM=y
CONFIG_TARGET_MESON_T5D=y
CONFIG_T5D_AM319_V1=y
CONFIG_DM=y
CONFIG_DM_GPIO=y
CONFIG_AML_GPIO=y
```

## board/amlogic/defconfigs/t5m_ay301_defconfig
```kconfig
CONFIG_ARM=y
CONFIG_ARCH_MESON=y
CONFIG_SYS_TEXT_BASE=0x00000000
CONFIG_MESON_T5M=y
CONFIG_T5M_AY301=y
CONFIG_PXP_EMULATOR=y
# CONFIG_AML_REBOOT is not set
CONFIG_DEBUG_UART_BASE=0xfe07a000
CONFIG_DEBUG_UART_CLOCK=24000000
CONFIG_DEBUG_UART=y
CONFIG_OF_BOARD_SETUP=y
CONFIG_BOOTCOMMAND="echo bootcmd"
CONFIG_BOARD_LATE_INIT=y
# CONFIG_DISPLAY_CPUINFO is not set
# CONFIG_DISPLAY_BOARDINFO is not set
CONFIG_SYS_PROMPT="t5m_ay301# "
# CONFIG_CMD_BDI is not set
# CONFIG_CMD_DSPSET is not set
# CONFIG_CMD_IMI is not set
CONFIG_CMD_CLKMSR=y
CONFIG_CMD_GPIO=y
CONFIG_CMD_I2C=y
# CONFIG_CMD_LOADB is not set
# CONFIG_CMD_LOADS is not set
CONFIG_CMD_MTD=y
CONFIG_AML_STORAGE=y
# CONFIG_CMD_PINMUX is not set
# CONFIG_CMD_ITEST is not set
# CONFIG_CMD_SETEXPR is not set
# CONFIG_CMD_NET is not set
# CONFIG_CMD_MISC is not set
# CONFIG_CMD_DDR_TEST is not set
# CONFIG_CMD_OS_IDENT is not set
CONFIG_CMD_WATCHDOG=y
# CONFIG_CMD_EFUSE is not set
CONFIG_OF_CONTROL=y
CONFIG_OF_EMBED=y
CONFIG_DEFAULT_DEVICE_TREE="meson-t5m-ay301"
CONFIG_CLK=y
CONFIG_CLK_MESON=y
CONFIG_CLK_MESON_T5M=y
CONFIG_DM_GPIO=y
CONFIG_DM_I2C=y
CONFIG_SYS_I2C_MESON=y
CONFIG_MISC=y
# CONFIG_MMC is not set
CONFIG_PHY=y
CONFIG_PINCTRL=y
CONFIG_PINCONF=y
CONFIG_PINCTRL_MESON_T5M=y
CONFIG_DM_REGULATOR=y
CONFIG_DEBUG_UART_MESON=y
CONFIG_DEBUG_UART_ANNOUNCE=y
CONFIG_DEBUG_UART_SKIP_INIT=y
CONFIG_MESON_SERIAL=y
CONFIG_WDT=y
CONFIG_WDT_MESON=y
CONFIG_AML_DRIVER=y
CONFIG_SECURE_POWER_CONTROL=y
CONFIG_AML_MEDIA=y
CONFIG_AML_VOUT=y
CONFIG_AML_OSD=y
CONFIG_AML_VPP=y
CONFIG_AML_VPU=y
CONFIG_AML_LCD=y
#CONFIG_AML_LCD_TCON=y
CONFIG_AML_LCD_TV=y
CONFIG_AML_LCD_TABLET=y
CONFIG_AML_LCD_EXTERN=y
CONFIG_AML_LCD_BACKLIGHT=y
CONFIG_SHA1=y
CONFIG_SHA256=y
```
