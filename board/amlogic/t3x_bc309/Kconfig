## board/amlogic/t3x_bc309/Kconfig
```kconfig
if TARGET_T3X_BC309

config SYS_SOC
	default "t3x"

config SYS_BOARD
	default "t3x_bc309"

config SYS_VENDOR
	default "amlogic"

config SYS_CONFIG_NAME
	default "t3x_bc309"

config DTB_BIND_KERNEL
    bool "load dtb from boot part but not flash rsv"
    default n

config AML_REBOOT
       bool "reboot cmd"
       default y
       help
         support uboot reboot cmd
endif
```

## board/amlogic/t3x_sky/Kconfig
```kconfig
if TARGET_T3X_SKY

config SYS_SOC
	default "t3x"

config SYS_BOARD
	default "t3x_sky"

config SYS_VENDOR
	default "amlogic"

config SYS_CONFIG_NAME
	default "t3x_sky"

config DTB_BIND_KERNEL
    bool "load dtb from boot part but not flash rsv"
    default n

config AML_REBOOT
       bool "reboot cmd"
       default y
       help
         support uboot reboot cmd
endif
```

## board/amlogic/t5_ak321_v1/Kconfig
```kconfig
if TARGET_MESON_T5

config SYS_CPU
	string
	default "armv8"

config SYS_BOARD
	string
	default "t5_ak321_v1"

config SYS_VENDOR
	string
	default "amlogic"

config SYS_SOC
	string
	default "t5"

config SYS_CONFIG_NAME
	default "t5_ak321_v1"

config BL30_SELECT
	string "T5 BL30 board config"
	default "t5_ak301_v1"

endif
```

## board/amlogic/t5d_am309_v1/Kconfig
```kconfig
if TARGET_MESON_T5D

config SYS_CPU
	string
	default "armv8"

config SYS_BOARD
	string
	default "t5d_am309_v1"

config SYS_VENDOR
	string
	default "amlogic"

config SYS_SOC
	string
	default "t5d"

config SYS_CONFIG_NAME
	default "t5d_am309_v1"

config BL30_SELECT
	string "T5D BL30 board config"
	default "t5d_am309_v1"

endif
```

## board/amlogic/t5d_skt_v1/Kconfig
```kconfig
if TARGET_MESON_T5D

config SYS_CPU
	string
	default "armv8"

config SYS_BOARD
	string
	default "t5d_skt_v1"

config SYS_VENDOR
	string
	default "amlogic"

config SYS_SOC
	string
	default "t5d"

config SYS_CONFIG_NAME
	default "t5d_skt_v1"

config BL30_SELECT
	string "T5D BL30 board config"
	default "t5_ak329_v1"

endif
```

## board/amlogic/t5m_ay309/Kconfig
```kconfig
if TARGET_T5M_AY309

config SYS_SOC
	default "t5m"

config SYS_BOARD
	default "t5m_ay309"

config SYS_VENDOR
	default "amlogic"

config SYS_CONFIG_NAME
	default "t5m_ay309"

config DTB_BIND_KERNEL
    bool "load dtb from boot part but not flash rsv"
    default n

config AML_REBOOT
       bool "reboot cmd"
       default y
       help
         support uboot reboot cmd
endif
```

## board/amlogic/t5w_at301_v1/Kconfig
```kconfig
if TARGET_T5W_AT301_V1

config SYS_SOC
	default "t5w"

config SYS_BOARD
	default "t5w_at301_v1"

config SYS_VENDOR
	default "amlogic"

config SYS_CONFIG_NAME
	default "t5w_at301_v1"

config BL30_SELECT
	string "T5w BL30 board config"
	default "t5w_at301"

endif
```

## board/amlogic/t5w_skt_v1/Kconfig
```kconfig
if TARGET_MESON_T5W

config SYS_CPU
	string
	default "armv8"

config SYS_BOARD
	string
	default "t5w_skt_v1"

config SYS_VENDOR
	string
	default "amlogic"

config SYS_SOC
	string
	default "t5w"

config SYS_CONFIG_NAME
	default "t5w_skt_v1"

config BL30_SELECT
	string "T5w BL30 board config"
	default "t5w_skt"

endif
```

## board/amlogic/t7_an400_lpddr4x/Kconfig
```kconfig
if TARGET_T7_AN400_LPDDR4X

config ENV_HDMITX_ONLY
	string
	option env="BOARD_COMPILE_HDMITX_ONLY"

config HDMITX_ONLY
	bool "hdmi tx only"
	default y if ENV_HDMITX_ONLY="true"

config SYS_SOC
	default "t7"

config SYS_BOARD
	default "t7_an400_lpddr4x"

config SYS_VENDOR
	default "amlogic"

config SYS_CONFIG_NAME
	default "t7_an400_lpddr4x"

config DTB_BIND_KERNEL
    bool "load dtb from boot part but not flash rsv"
    default n

config CMD_PLLTEST
	bool "support plltest command"
	default n
	help
	  support plltest command

config AML_REBOOT
       bool "reboot cmd"
       default y
       help
         support uboot reboot cmd
endif
```

## board/amlogic/t7_an400_lpddr4x_bluebell/Kconfig
```kconfig
if TARGET_T7_AN400_LPDDR4X_BLUEBELL

config ENV_HDMITX_ONLY
	string
	option env="BOARD_COMPILE_HDMITX_ONLY"

config HDMITX_ONLY
	bool "hdmi tx only"
	default y if ENV_HDMITX_ONLY="true"

config SYS_SOC
	default "t7"

config SYS_BOARD
	default "t7_an400_lpddr4x_bluebell"

config SYS_VENDOR
	default "amlogic"

config SYS_CONFIG_NAME
	default "t7_an400_lpddr4x_bluebell"

config DTB_BIND_KERNEL
    bool "load dtb from boot part but not flash rsv"
    default n

config AML_REBOOT
       bool "reboot cmd"
       default y
       help
         support uboot reboot cmd
endif
```

## board/amlogic/t7_an400_mercury/Kconfig
```kconfig
if TARGET_T7_AN400_MERCURY

config ENV_HDMITX_ONLY
	string
	option env="BOARD_COMPILE_HDMITX_ONLY"

config HDMITX_ONLY
	bool "hdmi tx only"
	default y if ENV_HDMITX_ONLY="true"

config SYS_SOC
	default "t7"

config SYS_BOARD
	default "t7_an400_mercury"

config SYS_VENDOR
	default "amlogic"

config SYS_CONFIG_NAME
	default "t7_an400_mercury"

config DTB_BIND_KERNEL
    bool "load dtb from boot part but not flash rsv"
    default n

config CMD_PLLTEST
	bool "support plltest command"
	default n

config AML_REBOOT
       bool "reboot cmd"
       default y
endif
```

## board/amlogic/t7_an400p_lpddr4x/Kconfig
```kconfig
if TARGET_T7_AN400P_LPDDR4X

config SYS_SOC
	default "t7"

config SYS_BOARD
	default "t7_an400p_lpddr4x"

config SYS_VENDOR
	default "amlogic"

config SYS_CONFIG_NAME
	default "t7_an400p_lpddr4x"

config DTB_BIND_KERNEL
    bool "load dtb from boot part but not flash rsv"
    default n

config CMD_PLLTEST
	bool "support plltest command"
	default n
	help
	  support plltest command

config AML_REBOOT
       bool "reboot cmd"
       default y
       help
         support uboot reboot cmd
endif
```

## board/amlogic/t7_an40a1/Kconfig
```kconfig
if TARGET_T7_AN40A1

config SYS_SOC
	default "t7"

config SYS_BOARD
	default "t7_an40a1"

config SYS_VENDOR
	default "amlogic"

config SYS_CONFIG_NAME
	default "t7_an40a1"

config DTB_BIND_KERNEL
    bool "load dtb from boot part but not flash rsv"
    default n

config CMD_PLLTEST
	bool "support plltest command"
	default n
	help
	  support plltest command

config AML_REBOOT
       bool "reboot cmd"
       default y
       help
         support uboot reboot cmd
endif
```

## board/amlogic/txhd2_be301/Kconfig
```kconfig
if TARGET_TXHD2_BE301

config SYS_CPU
	string
	default "armv8"

config SYS_BOARD
	string
	default "txhd2_be301"

config SYS_VENDOR
	string
	default "amlogic"

config SYS_SOC
	string
	default "txhd2"

config SYS_CONFIG_NAME
	default "txhd2_be301"

config BL30_SELECT
	string "TXHD2 BL30 board config"
	default "txhd2_be301"

config AML_REBOOT
	bool "reboot cmd"
	default y
	help
	  support uboot reboot cmd:
	  set reboot mode and reboot system
endif
```

## board/amlogic/txhd2_be312/Kconfig
```kconfig
if TARGET_TXHD2_BE312

config SYS_CPU
	string
	default "armv8"

config SYS_BOARD
	string
	default "txhd2_be312"

config SYS_VENDOR
	string
	default "amlogic"

config SYS_SOC
	string
	default "txhd2"

config SYS_CONFIG_NAME
	default "txhd2_be312"

config BL30_SELECT
	string "TXHD2 BL30 board config"
	default "txhd2_be311"

config AML_REBOOT
	bool "reboot cmd"
	default y
	help
	  support uboot reboot cmd:
	  set reboot mode and reboot system
endif
```

## board/khadas/Kconfig
```kconfig
config KHADAS_VIM3
	bool "Support Khadas VIM3 board"
	default n

if KHADAS_VIM3
source "board/khadas/kvim3/Kconfig"
endif
```

## board/khadas/defconfigs/kvim3_defconfig
```kconfig
CONFIG_ARM=y
CONFIG_TARGET_MESON_G12B=y
CONFIG_KHADAS_VIM3=y
CONFIG_DM=y
CONFIG_DM_GPIO=y
CONFIG_AML_GPIO=y
```

## board/khadas/defconfigs/kvim3l_defconfig
```kconfig
CONFIG_ARM=y
CONFIG_TARGET_MESON_G12A=y
CONFIG_KHADAS_VIM3L=y
CONFIG_DM=y
CONFIG_DM_GPIO=y
CONFIG_AML_GPIO=y
```

## board/khadas/kedge2/Kconfig
```kconfig
if TARGET_KEDGE2

config SYS_BOARD
	default "kedge2"

config SYS_VENDOR
	default "khadas"

config SYS_CONFIG_NAME
	default "kedge2"

config BOARD_SPECIFIC_OPTIONS # dummy
	def_bool y

endif
```

## board/khadas/kvim/Kconfig
```kconfig
if TARGET_MESON_GX

config SYS_CPU
	string
	default "armv8"

config SYS_BOARD
	string
	default "kvim"

config SYS_VENDOR
	string
	default "khadas"

config SYS_SOC
	string
	default "gxl"

config SYS_CONFIG_NAME
	default "kvim"

endif
```

## board/khadas/kvim1s/Kconfig
```kconfig
if TARGET_KHADAS_VIM1S

config SYS_SOC
	default "s4"

config SYS_BOARD
	default "kvim1s"

config SYS_VENDOR
	default "khadas"

config SYS_CONFIG_NAME
	default "kvim1s"

config DTB_BIND_KERNEL
    bool "load dtb from boot part but not flash rsv"
    default n

config AML_REBOOT
       bool "reboot cmd"
       default y
       help
         support uboot reboot cmd
endif
```

## board/khadas/kvim2/Kconfig
```kconfig
if TARGET_MESON_GX

config SYS_CPU
	string
	default "armv8"

config SYS_BOARD
	string
	default "kvim2"

config SYS_VENDOR
	string
	default "khadas"

config SYS_SOC
	string
	default "gxl"

config SYS_CONFIG_NAME
	default "kvim2"

endif
```

## board/khadas/kvim2l/Kconfig
```kconfig
if TARGET_MESON_GX

config SYS_CPU
	string
	default "armv8"

config SYS_BOARD
	string
	default "kvim2l"

config SYS_VENDOR
	string
	default "khadas"

config SYS_SOC
	string
	default "gxl"

config SYS_CONFIG_NAME
	default "kvim2l"

endif
```

## board/khadas/kvim3/Kconfig
```kconfig
if TARGET_MESON_G12B

config SYS_CPU
	string
	default "armv8"

config SYS_BOARD
	string
	default "kvim3"

config SYS_VENDOR
	string
	default "khadas"

config SYS_SOC
	string
	default "g12b"

config SYS_CONFIG_NAME
	default "kvim3"

endif
```

## board/khadas/kvim3l/Kconfig
```kconfig
if TARGET_MESON_G12A

config SYS_CPU
	string
	default "armv8"

config SYS_BOARD
	string
	default "kvim3l"

config SYS_VENDOR
	string
	default "khadas"

config SYS_SOC
	string
	default "g12a"

config SYS_CONFIG_NAME
	default "kvim3l"

endif
```
